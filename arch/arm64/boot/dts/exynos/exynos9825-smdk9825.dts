/dts-v1/;

/ {
	compatible = "samsung,exynos9820", "samsung,SMDK9820";
	board_id = <0xff>;
	board_rev = <0x0>;

	fragment@mipi_freq {
		target-path = [2f 00];

		__overlay__ {

			freq_1150 {
				hs-clk = <0x47e>;
				pmsk = <0x2 0xb1 0x2 0xec4f 0x0 0x0 0x0 0x0 0x0 0x0 0x0 0x0 0x0 0x0>;
				escape-clk = <0x14>;
				cmd_underrun_lp_ref = <0x579>;
				linux,phandle = <0x3>;
				phandle = <0x3>;
			};

			freq_1157 {
				hs-clk = <0x485>;
				pmsk = <0x2 0xb8 0x2 0x0 0x0 0x0 0x0 0x0 0x0 0x0 0x0 0x0 0x0 0x0>;
				escape-clk = <0x14>;
				cmd_underrun_lp_ref = <0x5bd>;
				linux,phandle = <0x4>;
				phandle = <0x4>;
			};

			freq_1176 {
				hs-clk = <0x498>;
				pmsk = <0x2 0xb5 0x2 0xec4f 0x0 0x0 0x0 0x0 0x0 0x0 0x0 0x0 0x0 0x0>;
				escape-clk = <0x14>;
				cmd_underrun_lp_ref = <0x675>;
				linux,phandle = <0x1>;
				phandle = <0x1>;
			};

			freq_1195 {
				hs-clk = <0x4ab>;
				pmsk = <0x2 0xb8 0x2 0xb13b 0x0 0x0 0x0 0x0 0x0 0x0 0x0 0x0 0x0 0x0>;
				escape-clk = <0x14>;
				cmd_underrun_lp_ref = <0x72d>;
				linux,phandle = <0x2>;
				phandle = <0x2>;
			};
		};
	};

	fragment@lcd {
		target-path = [2f 00];

		__overlay__ {

			emul_display {
				mode = <0x0>;
				resolution = <0x140 0xf0>;
				size = <0x50 0x78>;
				timing,refresh = <0x3c>;
				timing,h-porch = <0x14 0x14 0x14>;
				timing,v-porch = <0x14 0x14 0x14>;
				timing,dsi-hs-clk = <0x258>;
				timing,pmsk = <0x1 0x60 0x2 0x0>;
				timing,dsi-escape-clk = <0x14>;
				underrun_lp_ref = <0x133>;
				mic_en = <0x0>;
				mic_ratio = <0x0>;
				mic_ver = <0x2>;
				type_of_ddi = <0x0>;
				dsc_en = <0x0>;
				dsc_cnt = <0x0>;
				dsc_slice_num = <0x0>;
				data_lane = <0x4>;
				cmd_underrun_lp_ref = <0x4b3>;
				vt_compensation = <0x29eb>;
				hdr_num = <0x0>;
				hdr_type = <0x0 0x0 0x0 0x0>;
				hdr_max_luma = <0x0>;
				hdr_max_avg_luma = <0x0>;
				hdr_min_luma = <0x0>;
				linux,phandle = <0x23>;
				phandle = <0x23>;
			};

			s6e3hf4_wqhd {
				mode = <0x2>;
				resolution = <0x5a0 0xa00>;
				size = <0x44 0x7a>;
				timing,refresh = <0x3c>;
				timing,h-porch = <0x2 0x2 0x2>;
				timing,v-porch = <0xf 0x3 0x1>;
				timing,dsi-hs-clk = <0x44c>;
				timing,pmsk = <0x3 0xfe 0x2 0x0>;
				timing,dsi-escape-clk = <0x14>;
				mic_en = <0x0>;
				mic_ratio = <0x2>;
				mic_ver = <0x2>;
				type_of_ddi = <0x0>;
				dsc_en = <0x1>;
				dsc_cnt = <0x2>;
				dsc_slice_num = <0x4>;
				dsc_slice_h = <0x40>;
				data_lane = <0x4>;
				cmd_underrun_lp_ref = <0x15fd>;
				mres_en = <0x0>;
				mres_number = <0x1>;
				mres_width = <0x5a0 0x0 0x0>;
				mres_height = <0xa00 0x0 0x0>;
				mres_dsc_width = <0x168 0x0 0x0>;
				mres_dsc_height = <0x40 0x0 0x0>;
				mres_dsc_en = <0x1 0x0 0x0>;
				hdr_num = <0x1>;
				hdr_type = <0x2 0x0 0x0 0x0>;
				hdr_max_luma = <0x5265c0>;
				hdr_max_avg_luma = <0x124f80>;
				hdr_min_luma = <0x5>;
				linux,phandle = <0x13>;
				phandle = <0x13>;
			};

			s6e3ha2k_wqhd {
				mode = <0x2>;
				resolution = <0x5a0 0xa00>;
				size = <0x50 0x78>;
				timing,refresh = <0x3c>;
				timing,h-porch = <0x2 0x2 0x2>;
				timing,v-porch = <0x13 0x3 0x1>;
				timing,dsi-hs-clk = <0x44c>;
				timing,pmsk = <0x3 0x7f 0x0 0x0>;
				timing,dsi-escape-clk = <0x14>;
				mic_en = <0x1>;
				mic_ratio = <0x0>;
				mic_ver = <0x2>;
				type_of_ddi = <0x0>;
				dsc_en = <0x0>;
				dsc_cnt = <0x0>;
				dsc_slice_num = <0x0>;
				dsc_slice_h = <0x0>;
				data_lane = <0x4>;
				cmd_underrun_lp_ref = <0x4b3>;
				mres_en = <0x0>;
				mres_number = <0x1>;
				mres_width = <0x5a0 0x0 0x0>;
				mres_height = <0xa00 0x0 0x0>;
				mres_dsc_width = <0x0 0x0 0x0>;
				mres_dsc_height = <0x0 0x0 0x0>;
				mres_dsc_en = <0x0 0x0 0x0>;
				hdr_num = <0x1>;
				hdr_type = <0x2 0x0 0x0 0x0>;
				hdr_max_luma = <0x5265c0>;
				hdr_max_avg_luma = <0x124f80>;
				hdr_min_luma = <0x5>;
				linux,phandle = <0x24>;
				phandle = <0x24>;
			};

			s6e3ha3_wqhd {
				mode = <0x2>;
				resolution = <0x5a0 0xa00>;
				size = <0x46 0x79>;
				timing,refresh = <0x3c>;
				timing,h-porch = <0x2 0x2 0x2>;
				timing,v-porch = <0x13 0x3 0x1>;
				timing,dsi-hs-clk = <0x44c>;
				timing,pmsk = <0x3 0x7f 0x0 0x0>;
				timing,dsi-escape-clk = <0x14>;
				mic_en = <0x0>;
				mic_ratio = <0x2>;
				mic_ver = <0x2>;
				type_of_ddi = <0x0>;
				dsc_en = <0x1>;
				dsc_cnt = <0x1>;
				dsc_slice_num = <0x1>;
				dsc_slice_h = <0x20>;
				data_lane = <0x4>;
				cmd_underrun_lp_ref = <0x4b3>;
				mres_en = <0x0>;
				mres_number = <0x1>;
				mres_width = <0x5a0 0x0 0x0>;
				mres_height = <0xa00 0x0 0x0>;
				mres_dsc_width = <0x5a0 0x0 0x0>;
				mres_dsc_height = <0x20 0x0 0x0>;
				mres_dsc_en = <0x1 0x0 0x0>;
				hdr_num = <0x1>;
				hdr_type = <0x2 0x0 0x0 0x0>;
				hdr_max_luma = <0x5265c0>;
				hdr_max_avg_luma = <0x124f80>;
				hdr_min_luma = <0x5>;
				linux,phandle = <0x25>;
				phandle = <0x25>;
			};

			s6e3ha6_ddi {
				mode = <0x2>;
				resolution = <0x5a0 0xb90>;
				size = <0x45 0x8e>;
				timing,refresh = <0x3c>;
				timing,h-porch = <0x2 0x2 0x2>;
				timing,v-porch = <0xf 0x3 0x1>;
				timing,dsi-hs-clk = <0x382>;
				timing,pmsk = <0x2 0x114 0x2 0x4ec5 0xd 0x6 0x0 0x0 0x0 0x0 0x0 0x0 0x0 0x0>;
				timing,dsi-escape-clk = <0x14>;
				mic_en = <0x0>;
				mic_ratio = <0x2>;
				mic_ver = <0x2>;
				type_of_ddi = <0x0>;
				dsc_en = <0x1>;
				dsc_cnt = <0x2>;
				dsc_slice_num = <0x2>;
				dsc_slice_h = <0x28>;
				data_lane = <0x4>;
				cmd_underrun_lp_ref = <0xea0 0x14ef 0x110f>;
				mres_en = <0x1>;
				mres_number = <0x3>;
				mres_width = <0x5a0 0x438 0x2d0>;
				mres_height = <0xb90 0x8ac 0x5c8>;
				mres_dsc_width = <0x2d0 0x21c 0x168>;
				mres_dsc_height = <0x28 0x1e 0x4a>;
				mres_dsc_en = <0x1 0x1 0x0>;
				hdr_num = <0x1>;
				hdr_type = <0x2 0x0 0x0 0x0>;
				hdr_max_luma = <0x5265c0>;
				hdr_max_avg_luma = <0x124f80>;
				hdr_min_luma = <0x5>;
				linux,phandle = <0x26>;
				phandle = <0x26>;
			};

			s6e3ha8_ddi {
				mode = <0x2>;
				resolution = <0x5a0 0xb90>;
				size = <0x45 0x8e>;
				timing,refresh = <0x3c>;
				timing,h-porch = <0x2 0x2 0x2>;
				timing,v-porch = <0xf 0x8 0x1>;
				timing,dsi-hs-clk = <0x382>;
				timing,pmsk = <0x2 0x8a 0x2 0x2762 0xd 0x3 0x0 0x0 0x0 0x0 0x0 0x0 0x0 0x0>;
				timing,dsi-escape-clk = <0x14>;
				mic_en = <0x0>;
				mic_ratio = <0x2>;
				mic_ver = <0x2>;
				type_of_ddi = <0x0>;
				dsc_en = <0x1>;
				dsc_cnt = <0x2>;
				dsc_slice_num = <0x2>;
				dsc_slice_h = <0x28>;
				data_lane = <0x4>;
				cmd_underrun_lp_ref = <0xbce 0x14ef 0x1b77>;
				mres_en = <0x1>;
				mres_number = <0x3>;
				mres_width = <0x5a0 0x438 0x2d0>;
				mres_height = <0xb90 0x8ac 0x5c8>;
				mres_dsc_width = <0x2d0 0x21c 0x168>;
				mres_dsc_height = <0x28 0x1e 0x4a>;
				mres_dsc_en = <0x1 0x1 0x1>;
				hdr_num = <0x1>;
				hdr_type = <0x2 0x0 0x0 0x0>;
				hdr_max_luma = <0x5265c0>;
				hdr_max_avg_luma = <0x124f80>;
				hdr_min_luma = <0x5>;
				linux,phandle = <0x27>;
				phandle = <0x27>;
			};

			s6e3ha9_ddi {
				mode = <0x2>;
				resolution = <0x5a0 0xbe0>;
				size = <0x45 0x8e>;
				timing,refresh = <0x3c>;
				timing,h-porch = <0x2 0x2 0x2>;
				timing,v-porch = <0xf 0x8 0x1>;
				timing,dsi-hs-clk = <0x382>;
				timing,pmsk = <0x2 0x8a 0x2 0x2762 0xd 0x3 0x0 0x0 0x0 0x0 0x0 0x0 0x0 0x0>;
				timing,dsi-escape-clk = <0x14>;
				mic_en = <0x0>;
				mic_ratio = <0x2>;
				mic_ver = <0x2>;
				type_of_ddi = <0x0>;
				dsc_en = <0x1>;
				dsc_cnt = <0x2>;
				dsc_slice_num = <0x2>;
				dsc_slice_h = <0x28>;
				data_lane = <0x4>;
				cmd_underrun_lp_ref = <0xb3d 0x149e 0x1b52>;
				mres_en = <0x1>;
				mres_number = <0x3>;
				mres_width = <0x5a0 0x438 0x2d0>;
				mres_height = <0xbe0 0x8e8 0x5f0>;
				mres_dsc_width = <0x2d0 0x21c 0x168>;
				mres_dsc_height = <0x28 0x1e 0x4a>;
				mres_dsc_en = <0x1 0x1 0x1>;
				hdr_num = <0x1>;
				hdr_type = <0x2 0x0 0x0 0x0>;
				hdr_max_luma = <0x5265c0>;
				hdr_max_avg_luma = <0x124f80>;
				hdr_min_luma = <0x5>;
				linux,phandle = <0x28>;
				phandle = <0x28>;
			};

			s6e3fa9_m62 {
				mode = <0x2>;
				resolution = <0x438 0x960>;
				size = <0x46 0x9b>;
				timing,refresh = <0x3c>;
				timing,h-porch = <0x2 0x2 0x2>;
				timing,v-porch = <0xf 0x3 0x1>;
				timing,dsi-hs-clk = <0x498>;
				timing,pmsk = <0x2 0xb5 0x2 0xec4f 0x0 0x0 0x0 0x0 0x0 0x0 0x0 0x0 0x0 0x0>;
				timing,dsi-escape-clk = <0x14>;
				mic_en = <0x0>;
				mic_ratio = <0x2>;
				mic_ver = <0x2>;
				type_of_ddi = <0x0>;
				dsc_en = <0x0>;
				dsc_cnt = <0x2>;
				dsc_slice_num = <0x2>;
				dsc_slice_h = <0x28>;
				data_lane = <0x4>;
				cmd_underrun_lp_ref = <0x675>;
				mres_en = <0x0>;
				mres_number = <0x1>;
				mres_width = <0x438>;
				mres_height = <0x960>;
				mres_dsc_width = <0x21c>;
				mres_dsc_height = <0x28>;
				mres_dsc_en = <0x0 0x0>;
				mres_partial_width = <0x168>;
				mres_partial_height = <0xe4>;
				hdr_num = <0x3>;
				hdr_type = <0x2 0x3 0x4 0x0>;
				hdr_max_luma = <0x3d0900>;
				hdr_max_avg_luma = <0x124f80>;
				hdr_min_luma = <0x5>;
				partial_width = <0x168>;
				partial_height = <0xf0>;
				color_mode_num = <0x2>;
				color_mode = <0x0 0x9>;
				dynamic_freq = <0x1 0x2 0x3 0x4>;
				linux,phandle = <0x29>;
				phandle = <0x29>;
			};
		};
	};

	fragment@battery {
		target-path = [2f 00];

		__overlay__ {

			battery {
				status = "okay";
				compatible = "samsung,sec-battery";
				pinctrl-names = "default";
				battery,vendor = "SDI SDI";
				battery,charger_name = "s2mu004-charger";
				battery,fuelgauge_name = "s2mu004-fuelgauge";
				battery,technology = <0x2>;
				battery,temp_high = <0x1f4>;
				battery,temp_high_recovery = <0x1c2>;
				battery,temp_low = <0x64>;
				battery,temp_low_recovery = <0x96>;
				battery,full_check_count = <0x3>;
				battery,chg_full_vcell = <0x10d6>;
				battery,chg_recharge_vcell = <0x109a>;
				battery,max_rawsoc = <0x64>;
				battery,default_input_current = <0x3e8>;
				battery,default_charging_current = <0x3e8>;
				battery,default_full_check_current = <0x12c>;
				battery,max_input_current = <0x5dc>;
				battery,max_charging_current = <0x5dc>;
				battery,input_current_limit = <0x1f4 0x1c2 0x1f4 0x4b0 0x1f4 0x4b0 0x3e8 0x1f4 0x1f4 0x1f4 0x1f4 0x1f4 0x1f4 0x1f4 0x3e8 0x3e8 0x1f4 0x1f4 0x1f4 0x1f4 0x1f4 0x1f4 0x1f4 0x1f4 0x4b0 0x4b0 0x1f4 0x1f4 0x1f4 0x1f4 0x1f4 0x1f4 0x1f4 0x1f4 0x1f4 0x1f4 0x1f4 0x1f4 0x1f4 0x1f4 0x4b0 0x4b0 0x4b0 0x1f4 0x1f4 0x1f4 0x1f4>;
				battery,fast_charging_current = <0x1f4 0x1c2 0x1f4 0x4b0 0x1f4 0x4b0 0x3e8 0x1f4 0x1f4 0x1f4 0x1f4 0x1f4 0x1f4 0x1f4 0x3e8 0x3e8 0x1f4 0x1f4 0x1f4 0x1f4 0x1f4 0x1f4 0x1f4 0x1f4 0x4b0 0x4b0 0x1f4 0x1f4 0x1f4 0x1f4 0x1f4 0x1f4 0x1f4 0x1f4 0x1f4 0x1f4 0x1f4 0x1f4 0x1f4 0x1f4 0x4b0 0x4b0 0x4b0 0x1f4 0x1f4 0x1f4 0x1f4>;
				battery,full_check_current = <0x12c 0x0 0x12c 0x12c 0x12c 0x12c 0x12c 0x12c 0x12c 0x12c 0x12c 0x12c 0x12c 0x12c 0x12c 0x12c 0x12c 0x12c 0x12c 0x12c 0x12c 0x12c 0x12c 0x12c 0x12c 0x12c 0x12c 0x12c 0x12c 0x12c 0x12c 0x12c 0x12c 0x12c 0x12c 0x12c 0x12c 0x12c 0x12c 0x12c 0x12c 0x12c 0x12c 0x12c 0x12c 0x12c 0x12c>;
				battery,battery_table3 = <0xcc 0xb 0x3d 0xb 0xaf 0xa 0x22 0xa 0xa9 0x9 0x37 0x9 0xce 0x8 0x6b 0x8 0xe6 0x7 0xa6 0x7 0x4d 0x7 0xea 0x6 0xae 0x6 0x82 0x6 0x5f 0x6 0x43 0x6 0x24 0x6 0xfd 0x5 0xc5 0x5 0x93 0x5 0x2a 0x5 0xa8 0x1 0xf7 0x8 0x88 0x8 0x18 0x8 0xa9 0x7 0x3a 0x7 0xca 0x6 0x5b 0x6 0xec 0x5 0x7c 0x5 0xd 0x5 0x9e 0x4 0x2f 0x4 0xbf 0x3 0x50 0x3 0xe1 0x2 0x71 0x2 0x2 0x2 0x93 0x1 0x24 0x1 0xb4 0x0 0x45 0x0 0xd6 0xf>;
				battery,battery_table4 = <0x3e 0x3e 0x3d 0x3c 0x3d 0x3c 0x3b 0x3c 0x3c 0x3a 0x3a 0x3a 0x3a 0x3a 0x3a 0x3a 0x3b 0x3c 0x3e 0x40 0x4c 0x9a>;
				battery,batcap = <0xd0 0x20 0x34 0x8>;
				battery,accum = <0x8 0x0>;
				battery,soc_arr_val = <0x2bc5 0x29a6 0x2787 0x2567 0x2348 0x2128 0x1f09 0x1cea 0x1aca 0x18ab 0x168b 0x146c 0x124d 0x102d 0xe0e 0xbee 0x9cf 0x7b0 0x590 0x371 0x151 0xffffff32>;
				battery,ocv_arr_val = <0xaecb 0xac12 0xa959 0xa6a8 0xa45d 0xa230 0xa02e 0x9e4a 0x9bc0 0x9a8a 0x98d7 0x96f5 0x95cd 0x94f7 0x944e 0x93c4 0x932c 0x926d 0x915b 0x906a 0x8e66 0x7d45>;
			};
		};
	};

	fragment@camera {
		target-path = [2f 00];

		__overlay__ {

			fimc-is_sensor_2l7@5A {
				compatible = "samsung,sensor-module-2l7";
				pinctrl-names = "pin0", "pin1", "pin2", "release";
				pinctrl-0;
				pinctrl-1 = <0xffffffff>;
				pinctrl-2 = <0xffffffff>;
				pinctrl-3;
				position = <0x0>;
				id = <0x0>;
				mclk_ch = <0x0>;
				i2c_ch = <0x0>;
				gpio_mclk = <0xffffffff 0x4 0x1>;
				gpio_reset = <0xffffffff 0x0 0x1>;
				status = "okay";
				linux,phandle = <0x2a>;
				phandle = <0x2a>;

				af {
					product_name = <0xc>;
					i2c_ch = <0x0>;
				};

				flash {
					product_name = <0xb>;
				};
			};

			fimc-is-flash-gpio@0 {
				compatible = "samsung,sensor-flash-gpio";
				id = <0x0>;
				status = "okay";
				torch-gpio = <0xffffffff 0x3 0x1>;
				flash-gpio = <0xffffffff 0x2 0x1>;
				linux,phandle = <0x2b>;
				phandle = <0x2b>;
			};

			fimc-is_sensor_2p8@5A {
				compatible = "samsung,sensor-module-2p8";
				pinctrl-names = "pin0", "pin1", "pin2", "release";
				pinctrl-0;
				pinctrl-1 = <0xffffffff>;
				pinctrl-2 = <0xffffffff>;
				pinctrl-3;
				position = <0x1>;
				id = <0x1>;
				mclk_ch = <0x1>;
				i2c_ch = <0x1>;
				gpio_mclk = <0xffffffff 0x5 0x1>;
				gpio_reset = <0xffffffff 0x3 0x1>;
				status = "okay";
				linux,phandle = <0x2c>;
				phandle = <0x2c>;

				af {
					product_name = <0x7>;
					i2c_ch = <0x1>;
				};
			};

			fimc-is_sensor_3m3@5A {
				compatible = "samsung,sensor-module-3m3";
				pinctrl-names = "pin0", "pin1", "pin2", "release";
				pinctrl-0;
				pinctrl-1 = <0xffffffff>;
				pinctrl-2 = <0xffffffff>;
				pinctrl-3;
				position = <0x2>;
				id = <0x2>;
				mclk_ch = <0x0>;
				gpio_mclk = <0xffffffff 0x4 0x1>;
				gpio_reset = <0xffffffff 0x4 0x1>;
				power_seq_id = <0x1>;
				status = "disabled";
				linux,phandle = <0x2d>;
				phandle = <0x2d>;

				af {
					product_name = <0x64>;
				};
			};

			fimc-is_sensor_5e2@20 {
				compatible = "samsung,sensor-module-5e2";
				pinctrl-names = "pin0", "pin1", "pin2", "release";
				pinctrl-0;
				pinctrl-1 = <0xffffffff>;
				pinctrl-2 = <0xffffffff>;
				pinctrl-3;
				position = <0x3>;
				id = <0x3>;
				mclk_ch = <0x3>;
				gpio_mclk = <0xffffffff 0x7 0x1>;
				gpio_reset = <0xffffffff 0x0 0x1>;
				status = "disabled";
				linux,phandle = <0x2e>;
				phandle = <0x2e>;
			};
		};
	};

	fragment@0 {
		target = <0xffffffff>;

		__overlay__ {

			vender {
				rear_sensor_id = <0x23>;
				front_sensor_id = <0x14>;
				rear2_sensor_id = <0x21>;
				secure_sensor_id = <0x16>;
				front2_sensor_id = <0x16>;
			};

			fimc_is_dvfs {

				table0 {
					desc = "dvfs table v0.2 for 12M/8M";
					default_int_cam = <0xa8750>;
					default_cam = <0xa8750>;
					default_mif = <0x1ff3b0>;
					default_int = <0x186a0>;
					default_hpg = <0x1>;
					front2_preview_int_cam = <0xa1220>;
					front2_preview_cam = <0xa1220>;
					front2_preview_mif = <0x14a140>;
					front2_preview_int = <0x186a0>;
					front2_preview_hpg = <0x1>;
					front2_capture_int_cam = <0xa1220>;
					front2_capture_cam = <0xa1220>;
					front2_capture_mif = <0x14a140>;
					front2_capture_int = <0x186a0>;
					front2_capture_hpg = <0x1>;
					front2_video_int_cam = <0xa1220>;
					front2_video_cam = <0xa1220>;
					front2_video_mif = <0x14a140>;
					front2_video_int = <0x186a0>;
					front2_video_hpg = <0x1>;
					front2_video_capture_int_cam = <0xa1220>;
					front2_video_capture_cam = <0xa1220>;
					front2_video_capture_mif = <0x14a140>;
					front2_video_capture_int = <0x186a0>;
					front2_video_capture_hpg = <0x1>;
					front_preview_int_cam = <0xa1220>;
					front_preview_cam = <0xa6040>;
					front_preview_mif = <0x14a140>;
					front_preview_int = <0x186a0>;
					front_preview_hpg = <0x1>;
					front_preview_full_int_cam = <0xa1220>;
					front_preview_full_cam = <0xa6040>;
					front_preview_full_mif = <0x14a140>;
					front_preview_full_int = <0x186a0>;
					front_preview_full_hpg = <0x1>;
					front_capture_int_cam = <0xa1220>;
					front_capture_cam = <0xa6040>;
					front_capture_mif = <0x14a140>;
					front_capture_int = <0x186a0>;
					front_capture_hpg = <0x1>;
					front_video_int_cam = <0xa1220>;
					front_video_cam = <0xa6040>;
					front_video_mif = <0x14a140>;
					front_video_int = <0x186a0>;
					front_video_hpg = <0x1>;
					front_video_whd_int_cam = <0xa1220>;
					front_video_whd_cam = <0xa6040>;
					front_video_whd_mif = <0x14a140>;
					front_video_whd_int = <0x186a0>;
					front_video_whd_hpg = <0x1>;
					front_video_capture_int_cam = <0xa1220>;
					front_video_capture_cam = <0xa6040>;
					front_video_capture_mif = <0x14a140>;
					front_video_capture_int = <0x186a0>;
					front_video_capture_hpg = <0x1>;
					front_video_whd_capture_int_cam = <0xa1220>;
					front_video_whd_capture_cam = <0xa6040>;
					front_video_whd_capture_mif = <0x14a140>;
					front_video_whd_capture_int = <0x186a0>;
					front_video_whd_capture_hpg = <0x1>;
					front_dual_sync_preview_int_cam = <0xa6040>;
					front_dual_sync_preview_cam = <0xa6040>;
					front_dual_sync_preview_mif = <0x14a140>;
					front_dual_sync_preview_int = <0x186a0>;
					front_dual_sync_preview_hpg = <0x1>;
					front_dual_sync_capture_int_cam = <0xa6040>;
					front_dual_sync_capture_cam = <0xa6040>;
					front_dual_sync_capture_mif = <0x177bb8>;
					front_dual_sync_capture_int = <0x186a0>;
					front_dual_sync_capture_hpg = <0x1>;
					front_dual_sync_video_fhd_int_cam = <0xa6040>;
					front_dual_sync_video_fhd_cam = <0xa6040>;
					front_dual_sync_video_fhd_mif = <0x14a140>;
					front_dual_sync_video_fhd_int = <0x186a0>;
					front_dual_sync_video_fhd_hpg = <0x1>;
					front_dual_sync_video_fhd_capture_int_cam = <0xa6040>;
					front_dual_sync_video_fhd_capture_cam = <0xa6040>;
					front_dual_sync_video_fhd_capture_mif = <0x177bb8>;
					front_dual_sync_video_fhd_capture_int = <0x186a0>;
					front_dual_sync_video_fhd_capture_hpg = <0x1>;
					front_vt1_int_cam = <0xa1220>;
					front_vt1_cam = <0xa1220>;
					front_vt1_mif = <0x14a140>;
					front_vt1_int = <0x186a0>;
					front_vt1_hpg = <0x1>;
					front_vt2_int_cam = <0xa1220>;
					front_vt2_cam = <0xa1220>;
					front_vt2_mif = <0x14a140>;
					front_vt2_int = <0x186a0>;
					front_vt2_hpg = <0x1>;
					front_vt4_int_cam = <0xa1220>;
					front_vt4_cam = <0xa1220>;
					front_vt4_mif = <0x14a140>;
					front_vt4_int = <0x186a0>;
					front_vt4_hpg = <0x1>;
					front_preview_high_speed_fps_int_cam = <0xa1220>;
					front_preview_high_speed_fps_cam = <0xa6040>;
					front_preview_high_speed_fps_mif = <0x14a140>;
					front_preview_high_speed_fps_int = <0x186a0>;
					front_preview_high_speed_fps_hpg = <0x1>;
					rear2_preview_fhd_int_cam = <0xa1220>;
					rear2_preview_fhd_cam = <0xa6040>;
					rear2_preview_fhd_mif = <0x14a140>;
					rear2_preview_fhd_int = <0x186a0>;
					rear2_preview_fhd_hpg = <0x1>;
					rear2_capture_int_cam = <0xa6040>;
					rear2_capture_cam = <0xa6040>;
					rear2_capture_mif = <0x14a140>;
					rear2_capture_int = <0x186a0>;
					rear2_capture_hpg = <0x1>;
					rear2_video_fhd_int_cam = <0xa1220>;
					rear2_video_fhd_cam = <0xa6040>;
					rear2_video_fhd_mif = <0x14a140>;
					rear2_video_fhd_int = <0x186a0>;
					rear2_video_fhd_hpg = <0x1>;
					rear2_video_fhd_capture_int_cam = <0xa6040>;
					rear2_video_fhd_capture_cam = <0xa6040>;
					rear2_video_fhd_capture_mif = <0x14a140>;
					rear2_video_fhd_capture_int = <0x186a0>;
					rear2_video_fhd_capture_hpg = <0x1>;
					rear_preview_fhd_int_cam = <0xa1220>;
					rear_preview_fhd_cam = <0xa6040>;
					rear_preview_fhd_mif = <0x14a140>;
					rear_preview_fhd_int = <0x186a0>;
					rear_preview_fhd_hpg = <0x1>;
					rear_preview_whd_int_cam = <0xa1220>;
					rear_preview_whd_cam = <0xa6040>;
					rear_preview_whd_mif = <0x14a140>;
					rear_preview_whd_int = <0x186a0>;
					rear_preview_whd_hpg = <0x1>;
					rear_preview_uhd_int_cam = <0xa1220>;
					rear_preview_uhd_cam = <0xa6040>;
					rear_preview_uhd_mif = <0x14a140>;
					rear_preview_uhd_int = <0x186a0>;
					rear_preview_uhd_hpg = <0x1>;
					rear_preview_uhd_60fps_int_cam = <0xa6040>;
					rear_preview_uhd_60fps_cam = <0xa6040>;
					rear_preview_uhd_60fps_mif = <0x177bb8>;
					rear_preview_uhd_60fps_int = <0x186a0>;
					rear_preview_uhd_60fps_hpg = <0x1>;
					rear_preview_full_int_cam = <0xa1220>;
					rear_preview_full_cam = <0xa6040>;
					rear_preview_full_mif = <0x14a140>;
					rear_preview_full_int = <0x186a0>;
					rear_preview_full_hpg = <0x1>;
					rear_capture_int_cam = <0xa6040>;
					rear_capture_cam = <0xa6040>;
					rear_capture_mif = <0x14a140>;
					rear_capture_int = <0x186a0>;
					rear_capture_hpg = <0x1>;
					rear_video_fhd_int_cam = <0xa1220>;
					rear_video_fhd_cam = <0xa6040>;
					rear_video_fhd_mif = <0x14a140>;
					rear_video_fhd_int = <0x186a0>;
					rear_video_fhd_hpg = <0x1>;
					rear_video_whd_int_cam = <0xa1220>;
					rear_video_whd_cam = <0xa6040>;
					rear_video_whd_mif = <0x14a140>;
					rear_video_whd_int = <0x186a0>;
					rear_video_whd_hpg = <0x1>;
					rear_video_uhd_int_cam = <0xa1220>;
					rear_video_uhd_cam = <0xa6040>;
					rear_video_uhd_mif = <0x14a140>;
					rear_video_uhd_int = <0x186a0>;
					rear_video_uhd_hpg = <0x1>;
					rear_video_uhd_60fps_int_cam = <0xa6040>;
					rear_video_uhd_60fps_cam = <0xa6040>;
					rear_video_uhd_60fps_mif = <0x177bb8>;
					rear_video_uhd_60fps_int = <0x186a0>;
					rear_video_uhd_60fps_hpg = <0x1>;
					rear_video_fhd_capture_int_cam = <0xa6040>;
					rear_video_fhd_capture_cam = <0xa6040>;
					rear_video_fhd_capture_mif = <0x14a140>;
					rear_video_fhd_capture_int = <0x186a0>;
					rear_video_fhd_capture_hpg = <0x1>;
					rear_video_whd_capture_int_cam = <0xa6040>;
					rear_video_whd_capture_cam = <0xa6040>;
					rear_video_whd_capture_mif = <0x14a140>;
					rear_video_whd_capture_int = <0x186a0>;
					rear_video_whd_capture_hpg = <0x1>;
					rear_video_uhd_capture_int_cam = <0xa6040>;
					rear_video_uhd_capture_cam = <0xa6040>;
					rear_video_uhd_capture_mif = <0x14a140>;
					rear_video_uhd_capture_int = <0x186a0>;
					rear_video_uhd_capture_hpg = <0x1>;
					dual_preview_int_cam = <0xa1220>;
					dual_preview_cam = <0xa6040>;
					dual_preview_mif = <0x14a140>;
					dual_preview_int = <0x186a0>;
					dual_preview_hpg = <0x1>;
					dual_capture_int_cam = <0xa6040>;
					dual_capture_cam = <0xa6040>;
					dual_capture_mif = <0x14a140>;
					dual_capture_int = <0x186a0>;
					dual_capture_hpg = <0x1>;
					dual_video_fhd_int_cam = <0xa1220>;
					dual_video_fhd_cam = <0xa6040>;
					dual_video_fhd_mif = <0x14a140>;
					dual_video_fhd_int = <0x186a0>;
					dual_video_fhd_hpg = <0x1>;
					dual_video_fhd_capture_int_cam = <0xa6040>;
					dual_video_fhd_capture_cam = <0xa6040>;
					dual_video_fhd_capture_mif = <0x14a140>;
					dual_video_fhd_capture_int = <0x186a0>;
					dual_video_fhd_capture_hpg = <0x1>;
					dual_video_uhd_int_cam = <0xa1220>;
					dual_video_uhd_cam = <0xa6040>;
					dual_video_uhd_mif = <0x14a140>;
					dual_video_uhd_int = <0x186a0>;
					dual_video_uhd_hpg = <0x1>;
					dual_video_uhd_capture_int_cam = <0xa6040>;
					dual_video_uhd_capture_cam = <0xa6040>;
					dual_video_uhd_capture_mif = <0x14a140>;
					dual_video_uhd_capture_int = <0x186a0>;
					dual_video_uhd_capture_hpg = <0x1>;
					dual_sync_preview_int_cam = <0xa6040>;
					dual_sync_preview_cam = <0xa6040>;
					dual_sync_preview_mif = <0x14a140>;
					dual_sync_preview_int = <0x186a0>;
					dual_sync_preview_hpg = <0x1>;
					dual_sync_capture_int_cam = <0xa6040>;
					dual_sync_capture_cam = <0xa6040>;
					dual_sync_capture_mif = <0x177bb8>;
					dual_sync_capture_int = <0x186a0>;
					dual_sync_capture_hpg = <0x1>;
					dual_sync_preview_whd_int_cam = <0xa6040>;
					dual_sync_preview_whd_cam = <0xa6040>;
					dual_sync_preview_whd_mif = <0x177bb8>;
					dual_sync_preview_whd_int = <0x186a0>;
					dual_sync_preview_whd_hpg = <0x1>;
					dual_sync_whd_capture_int_cam = <0xa6040>;
					dual_sync_whd_capture_cam = <0xa6040>;
					dual_sync_whd_capture_mif = <0x177bb8>;
					dual_sync_whd_capture_int = <0x186a0>;
					dual_sync_whd_capture_hpg = <0x1>;
					dual_sync_video_fhd_int_cam = <0xa6040>;
					dual_sync_video_fhd_cam = <0xa6040>;
					dual_sync_video_fhd_mif = <0x14a140>;
					dual_sync_video_fhd_int = <0x186a0>;
					dual_sync_video_fhd_hpg = <0x1>;
					dual_sync_video_fhd_capture_int_cam = <0xa6040>;
					dual_sync_video_fhd_capture_cam = <0xa6040>;
					dual_sync_video_fhd_capture_mif = <0x177bb8>;
					dual_sync_video_fhd_capture_int = <0x186a0>;
					dual_sync_video_fhd_capture_hpg = <0x1>;
					dual_sync_video_uhd_int_cam = <0xa6040>;
					dual_sync_video_uhd_cam = <0xa6040>;
					dual_sync_video_uhd_mif = <0x14a140>;
					dual_sync_video_uhd_int = <0x186a0>;
					dual_sync_video_uhd_hpg = <0x1>;
					dual_sync_video_uhd_capture_int_cam = <0xa6040>;
					dual_sync_video_uhd_capture_cam = <0xa6040>;
					dual_sync_video_uhd_capture_mif = <0x177bb8>;
					dual_sync_video_uhd_capture_int = <0x186a0>;
					dual_sync_video_uhd_capture_hpg = <0x1>;
					secure_front_int_cam = <0xa1220>;
					secure_front_cam = <0xa1220>;
					secure_front_mif = <0x14a140>;
					secure_front_int = <0x186a0>;
					secure_front_hpg = <0x1>;
					pip_preview_int_cam = <0xa6040>;
					pip_preview_cam = <0xa6040>;
					pip_preview_mif = <0x14a140>;
					pip_preview_int = <0x186a0>;
					pip_preview_hpg = <0x1>;
					pip_capture_int_cam = <0xa6040>;
					pip_capture_cam = <0xa6040>;
					pip_capture_mif = <0x14a140>;
					pip_capture_int = <0x186a0>;
					pip_capture_hpg = <0x1>;
					pip_video_int_cam = <0xa6040>;
					pip_video_cam = <0xa6040>;
					pip_video_mif = <0x14a140>;
					pip_video_int = <0x186a0>;
					pip_video_hpg = <0x1>;
					pip_video_capture_int_cam = <0xa6040>;
					pip_video_capture_cam = <0xa6040>;
					pip_video_capture_mif = <0x14a140>;
					pip_video_capture_int = <0x186a0>;
					pip_video_capture_hpg = <0x1>;
					preview_high_speed_fps_int_cam = <0xa1220>;
					preview_high_speed_fps_cam = <0xa6040>;
					preview_high_speed_fps_mif = <0x14a140>;
					preview_high_speed_fps_int = <0x186a0>;
					preview_high_speed_fps_hpg = <0x1>;
					video_high_speed_60fps_int_cam = <0xa6040>;
					video_high_speed_60fps_cam = <0xa6040>;
					video_high_speed_60fps_mif = <0x14a140>;
					video_high_speed_60fps_int = <0x186a0>;
					video_high_speed_60fps_hpg = <0x1>;
					video_high_speed_120fps_int_cam = <0xa1220>;
					video_high_speed_120fps_cam = <0xa6040>;
					video_high_speed_120fps_mif = <0x14a140>;
					video_high_speed_120fps_int = <0x186a0>;
					video_high_speed_120fps_hpg = <0x1>;
					video_high_speed_240fps_int_cam = <0xa6040>;
					video_high_speed_240fps_cam = <0xa6040>;
					video_high_speed_240fps_mif = <0x177bb8>;
					video_high_speed_240fps_int = <0x186a0>;
					video_high_speed_240fps_hpg = <0x1>;
					video_high_speed_dualfps_int_cam = <0xa6040>;
					video_high_speed_dualfps_cam = <0xa6040>;
					video_high_speed_dualfps_mif = <0x177bb8>;
					video_high_speed_dualfps_int = <0x186a0>;
					video_high_speed_dualfps_hpg = <0x6>;
					video_high_speed_60fps_capture_int_cam = <0xa6040>;
					video_high_speed_60fps_capture_cam = <0xa6040>;
					video_high_speed_60fps_capture_mif = <0x177bb8>;
					video_high_speed_60fps_capture_int = <0x186a0>;
					video_high_speed_60fps_capture_hpg = <0x1>;
					ext_front_int_cam = <0xa8750>;
					ext_front_cam = <0xa8750>;
					ext_front_mif = <0x1ff3b0>;
					ext_front_int = <0x825f0>;
					ext_front_hpg = <0x1>;
					ext_secure_int_cam = <0x9eb10>;
					ext_secure_cam = <0x9eb10>;
					ext_secure_mif = <0x14a140>;
					ext_secure_int = <0x186a0>;
					ext_secure_hpg = <0x1>;
					max_int_cam = <0xa8750>;
					max_cam = <0xa8750>;
					max_mif = <0x1ff3b0>;
					max_int = <0x825f0>;
					max_hpg = <0x1>;
				};
			};
		};
	};

	fragment@1 {
		target = <0xffffffff>;

		__overlay__ {

			hsi2c0-bus {
				samsung,pin-pud = <0x3>;
				linux,phandle = <0x6>;
				phandle = <0x6>;
			};

			hsi2c0-bus-in {
				samsung,pins = "gpc0-0", "gpc0-1";
				samsung,pin-function = <0x0>;
				samsung,pin-pud = <0x0>;
				samsung,pin-drv = <0x0>;
				linux,phandle = <0x5>;
				phandle = <0x5>;
			};

			hsi2c1-bus {
				samsung,pin-pud = <0x3>;
				linux,phandle = <0x8>;
				phandle = <0x8>;
			};

			hsi2c1-bus-in {
				samsung,pins = "gpc0-2", "gpc0-3";
				samsung,pin-function = <0x0>;
				samsung,pin-pud = <0x0>;
				samsung,pin-drv = <0x0>;
				linux,phandle = <0x7>;
				phandle = <0x7>;
			};

			hsi2c2-bus-in {
				samsung,pins = "gpc0-4", "gpc0-5";
				samsung,pin-function = <0x0>;
				samsung,pin-pud = <0x0>;
				samsung,pin-drv = <0x0>;
				linux,phandle = <0x9>;
				phandle = <0x9>;
			};

			hsi2c3-bus-in {
				samsung,pins = "gpc0-6", "gpc0-7";
				samsung,pin-function = <0x0>;
				samsung,pin-pud = <0x0>;
				samsung,pin-drv = <0x0>;
				linux,phandle = <0xa>;
				phandle = <0xa>;
			};
		};
	};

	fragment@2 {
		target = <0xffffffff>;

		__overlay__ {
			#address-cells = <0x1>;
			#size-cells = <0x0>;
			gpios = <0xffffffff 0x0 0x0 0xffffffff 0x1 0x0>;
			status = "okay";
			clock-frequency = <0x61a80>;
			samsung,reset-before-trans;
			pinctrl-names = "default", "on_i2c", "off_i2c";
			pinctrl-0 = <0x5>;
			pinctrl-1 = <0x6>;
			pinctrl-2 = <0x5>;

			fimc-is-2l7@10 {
				compatible = "samsung,exynos5-fimc-is-cis-2l7";
				reg = <0x2d>;
				id = <0x0>;
				setfile = "setB";
			};

			fimc-is-actuator@0C {
				compatible = "samsung,exynos5-fimc-is-actuator-ak7371";
				reg = <0xc>;
				id = <0x0>;
				vendor_product_id = <0x9>;
				vendor_first_pos = <0x78>;
				vendor_first_delay = <0x7d0>;
				vendor_first_delay_max = <0x7da>;
			};
		};
	};

	fragment@3 {
		target = <0xffffffff>;

		__overlay__ {
			#address-cells = <0x1>;
			#size-cells = <0x0>;
			gpios = <0xffffffff 0x2 0x0 0xffffffff 0x3 0x0>;
			status = "okay";
			clock-frequency = <0x61a80>;
			samsung,reset-before-trans;
			pinctrl-names = "default", "on_i2c", "off_i2c";
			pinctrl-0 = <0x7>;
			pinctrl-1 = <0x8>;
			pinctrl-2 = <0x7>;

			fimc-is-2p8@2D {
				compatible = "samsung,exynos5-fimc-is-cis-2p8";
				reg = <0x2d>;
				id = <0x1>;
				setfile = "default";
			};

			fimc-is-actuator@0C {
				compatible = "samsung,exynos5-fimc-is-actuator-ak7345";
				reg = <0xc>;
				id = <0x1>;
				place = <0x1>;
			};
		};
	};

	fragment@4 {
		target = <0xffffffff>;

		__overlay__ {
			#address-cells = <0x1>;
			#size-cells = <0x0>;
			gpios = <0xffffffff 0x4 0x0 0xffffffff 0x5 0x0>;
			status = "okay";
			clock-frequency = <0x61a80>;
			samsung,reset-before-trans;
			pinctrl-names = "default", "on_i2c", "off_i2c";
			pinctrl-0 = <0x9>;
			pinctrl-1 = <0xffffffff>;
			pinctrl-2 = <0x9>;

			fimc-is-3m3@20 {
				compatible = "samsung,exynos5-fimc-is-cis-3m3";
				reg = <0x10>;
				id = <0x2>;
				setfile = "default";
			};
		};
	};

	fragment@5 {
		target = <0xffffffff>;

		__overlay__ {
			#address-cells = <0x1>;
			#size-cells = <0x0>;
			gpios = <0xffffffff 0x6 0x0 0xffffffff 0x7 0x0>;
			status = "okay";
			clock-frequency = <0x61a80>;
			samsung,reset-before-trans;
			pinctrl-names = "default", "on_i2c", "off_i2c";
			pinctrl-0 = <0xa>;
			pinctrl-1 = <0xffffffff>;
			pinctrl-2 = <0xa>;

			fimc-is-5e2@10 {
				compatible = "samsung,exynos5-fimc-is-cis-5e2";
				reg = <0x10>;
				id = <0x3>;
				setfile = "default";
			};
		};
	};

	fragment@6 {
		target = <0xffffffff>;

		__overlay__ {
			scenario = <0x0>;
			id = <0x0>;
			csi_ch = <0x0>;
			dma_ch = <0x0 0x0 0x0 0x0 0x0 0x4 0x4 0x4>;
			vc_ch = <0x0 0x1 0x2 0x3 0x0 0x0 0x1 0x2>;
			flite_ch = <0x64>;
			is_bns = <0x0>;
			status = "okay";
		};
	};

	fragment@7 {
		target = <0xffffffff>;

		__overlay__ {
			scenario = <0x0>;
			id = <0x1>;
			csi_ch = <0x1>;
			dma_ch = <0x1 0x1 0x1 0x1>;
			vc_ch = <0x0 0x1 0x2 0x3>;
			flite_ch = <0x64>;
			is_bns = <0x0>;
			status = "okay";
		};
	};

	fragment@8 {
		target = <0xffffffff>;

		__overlay__ {
			scenario = <0x0>;
			id = <0x2>;
			csi_ch = <0x2>;
			dma_ch = <0x2 0x2 0x2 0x2>;
			vc_ch = <0x0 0x1 0x2 0x3>;
			flite_ch = <0x64>;
			is_bns = <0x0>;
			status = "disabled";
		};
	};

	fragment@9 {
		target = <0xffffffff>;

		__overlay__ {
			scenario = <0x6>;
			id = <0x3>;
			csi_ch = <0x3>;
			dma_ch = <0x3 0x3 0x3 0x3>;
			vc_ch = <0x0 0x1 0x2 0x3>;
			flite_ch = <0x64>;
			is_bns = <0x0>;
			status = "disabled";
		};
	};

	fragment@10 {
		target = <0xffffffff>;

		__overlay__ {
			scenario = <0x6>;
			id = <0x4>;
			csi_ch = <0x4>;
			dma_ch = <0x3 0x3 0x3 0x3>;
			vc_ch = <0x0 0x1 0x2 0x3>;
			flite_ch = <0x64>;
			is_bns = <0x0>;
			status = "disabled";
		};
	};

	fragment@model {
		target-path = [2f 00];

		__overlay__ {
			#address-cells = <0x2>;
			#size-cells = <0x1>;
			model = "Samsung SMDK9820 board based on EXYNOS9820";

			chosen {
				bootargs = "earlycon=exynos4210,0x10440000 console=ttySAC0,115200n8 bcm_setup=0xffffff80f8e00000 pmic_info=0x3 ccic_info=0x1 firmware_class.path=/vendor/firmware reserve-fimc=0xffffff80f9fe0000 sec_debug.cp=0 nohugeiomap";
				linux,initrd-start = <0x84000000>;
				linux,initrd-end = <0x841fffff>;
			};

			fixed-rate-clocks {

				oscclk {
					compatible = "samsung,exynos9820-oscclk";
					clock-frequency = <0x18cba80>;
				};
			};

			gpio_keys {
				status = "okay";
				compatible = "gpio-keys";
				pinctrl-names = "default";
				pinctrl-0 = <0xb 0xc 0xd 0xe>;

				button@1 {
					label = "gpio-keys: KEY_HOME";
					linux,code = <0xac>;
					gpios = <0xffffffff 0x7 0xf>;
					gpio-key,wakeup = <0x1>;
				};

				button@2 {
					label = "gpio-keys: KEY_VOLUMEDOWN";
					linux,code = <0x72>;
					gpios = <0xffffffff 0x1 0xf>;
				};

				button@3 {
					label = "gpio-keys: KEY_VOLUMEUP";
					linux,code = <0x73>;
					gpios = <0xffffffff 0x0 0xf>;
				};

				button@4 {
					label = "gpio-keys: KEY_POWER";
					linux,code = <0x74>;
					gpios = <0xffffffff 0x3 0xf>;
					gpio-key,wakeup = <0x1>;
				};
			};

			hs_tune {
				status = "disabled";
				hs_tune_cnt = <0x4>;
				linux,phandle = <0x15>;
				phandle = <0x15>;

				hs_tune1 {
					tune_name = "tx_pre_emp";
					tune_value = <0x3 0x3>;
				};

				hs_tune2 {
					tune_name = "tx_vref";
					tune_value = <0x7 0x7>;
				};

				hs_tune3 {
					tune_name = "rx_sqrx";
					tune_value = <0x5 0x5>;
				};

				hs_tune4 {
					tune_name = "utmi_clk";
					tune_value = <0x1 0x1>;
				};
			};

			ss_tune {
				status = "disabled";
				ss_tune_cnt = <0x14>;
				linux,phandle = <0x16>;
				phandle = <0x16>;

				ss_tune1 {
					tune_name = "ssrx_sqhs_th";
					tune_value = <0x4 0x4>;
				};

				ss_tune2 {
					tune_name = "ssrx_lfps_th";
					tune_value = <0x2 0x2>;
				};

				ss_tune3 {
					tune_name = "ssrx_mf_eq_en";
					tune_value = <0x1 0x1>;
				};

				ss_tune4 {
					tune_name = "ssrx_mf_eq_ctrl_ss";
					tune_value = <0x6 0x6>;
				};

				ss_tune5 {
					tune_name = "ssrx_hf_eq_ctrl_ss";
					tune_value = <0xe 0xe>;
				};

				ss_tune6 {
					tune_name = "ssrx_mf_eq_ctrl_ssp";
					tune_value = <0x6 0x6>;
				};

				ss_tune7 {
					tune_name = "ssrx_hf_eq_ctrl_ssp";
					tune_value = <0xe 0xe>;
				};

				ss_tune8 {
					tune_name = "ssrx_dfe1_tap_ctrl";
					tune_value = <0x2 0x2>;
				};

				ss_tune9 {
					tune_name = "ssrx_dfe2_tap_ctrl";
					tune_value = <0x0 0x0>;
				};

				ss_tune10 {
					tune_name = "ssrx_dfe3_tap_ctrl";
					tune_value = <0x0 0x0>;
				};

				ss_tune11 {
					tune_name = "ssrx_dfe4_tap_ctrl";
					tune_value = <0x0 0x0>;
				};

				ss_tune12 {
					tune_name = "ssrx_dfe5_tap_ctrl";
					tune_value = <0x0 0x0>;
				};

				ss_tune13 {
					tune_name = "ssrx_term_cal";
					tune_value = <0xb 0xb>;
				};

				ss_tune14 {
					tune_name = "sstx_amp";
					tune_value = <0xb 0xb>;
				};

				ss_tune15 {
					tune_name = "sstx_deemp";
					tune_value = <0x5 0x5>;
				};

				ss_tune16 {
					tune_name = "sstx_pre_shoot";
					tune_value = <0x3 0x3>;
				};

				ss_tune17 {
					tune_name = "sstx_idrv_up";
					tune_value = <0x7 0x7>;
				};

				ss_tune18 {
					tune_name = "sstx_idrv_dn";
					tune_value = <0x0 0x0>;
				};

				ss_tune19 {
					tune_name = "sstx_up_term";
					tune_value = <0x3 0x3>;
				};

				ss_tune20 {
					tune_name = "sstx_dn_term";
					tune_value = <0x3 0x3>;
				};
			};

			usb_notifier {
				compatible = "samsung,usb-notifier";
				udc = <0xffffffff>;
			};

			exynos_rgt {
				compatible = "samsung,exynos-rgt";
				num-acpm-pmic = <0x2>;
			};

			audio_codec_dummy {
				status = "okay";
				compatible = "snd-soc-dummy";
				linux,phandle = <0xf>;
				phandle = <0xf>;
			};

			audio_cpu_dummy {
				compatible = "samsung,dummy-cpu";
				status = "okay";
				linux,phandle = <0x2f>;
				phandle = <0x2f>;
			};

			sound {
				status = "okay";
				compatible = "samsung,exynos9820-madera";
				clock-names = "xclkout";
				clocks = <0xffffffff 0x385>;
				cirrus,sysclk = <0x1 0x4 0x5dc0000>;
				cirrus,dspclk = <0x8 0x4 0x8ca0000>;
				cirrus,fll1-refclk = <0x1 0x0 0x18cba80 0x5dc0000>;
				cirrus,asyncclk = <0x2 0x5 0x5622000>;
				cirrus,fll2-refclk = <0x2 0x0 0x18cba80 0x5622000>;
				samsung,routing = "HEADSETMIC", "MICBIAS1D", "IN1BL", "HEADSETMIC", "DMIC1", "MICBIAS1A", "IN3L", "DMIC1", "IN3R", "DMIC1", "DMIC2", "MICBIAS1B", "IN4L", "DMIC2", "DMIC3", "MICBIAS1C", "IN2AL", "DMIC3", "VTS PAD DPDM", "DMIC2", "RECEIVER", "HPOUT4L", "RECEIVER", "HPOUT4R", "HEADPHONE", "HPOUT2L", "HEADPHONE", "HPOUT2R", "BLUETOOTH SPK", "ABOX UAIF3 Playback", "ABOX UAIF3 Capture", "BLUETOOTH MIC", "VOUTPUT", "ABOX UAIF0 Playback", "ABOX UAIF1 Capture", "VINPUT1", "SPEAKER", "HiFi Playback", "VOUTPUTCALL", "ABOX UAIF2 Playback", "ABOX UAIF2 Capture", "VINPUTCALL", "VTS Input", "DMIC2";
				samsung,codec = <0xffffffff 0xffffffff 0xffffffff 0xffffffff 0xffffffff 0xffffffff 0xffffffff 0xffffffff 0xffffffff 0xffffffff 0xffffffff 0xffffffff 0xffffffff 0xffffffff 0xffffffff 0xffffffff 0xffffffff 0xffffffff 0xffffffff 0xffffffff 0xffffffff 0xffffffff 0xffffffff 0xffffffff 0xffffffff 0xffffffff 0xffffffff>;
				samsung,prefix = "ABOX", "ABOX", "ABOX", "ABOX", "ABOX", "ABOX", "ABOX", "ABOX", "ABOX", "ABOX", "ABOX", "ABOX", "ABOX", "ABOX", "ABOX", "ABOX", "ABOX", "ABOX", "ABOX", "ABOX", "ABOX", "ABOX", "ABOX", "ABOX", "ABOX", "ABOX", "VTS";
				samsung,aux = <0xffffffff>;

				rdma0 {

					cpu {
						sound-dai = <0xffffffff>;
					};

					platform {
						sound-dai = <0xffffffff>;
					};

					codec {
						sound-dai = <0xf>;
					};
				};

				rdma1 {

					cpu {
						sound-dai = <0xffffffff>;
					};

					platform {
						sound-dai = <0xffffffff>;
					};

					codec {
						sound-dai = <0xf>;
					};
				};

				rdma2 {

					cpu {
						sound-dai = <0xffffffff>;
					};

					platform {
						sound-dai = <0xffffffff>;
					};

					codec {
						sound-dai = <0xf>;
					};
				};

				rdma3 {

					cpu {
						sound-dai = <0xffffffff>;
					};

					platform {
						sound-dai = <0xffffffff>;
					};

					codec {
						sound-dai = <0xf>;
					};
				};

				rdma4 {

					cpu {
						sound-dai = <0xffffffff>;
					};

					platform {
						sound-dai = <0xffffffff>;
					};

					codec {
						sound-dai = <0xf>;
					};
				};

				rdma5 {

					cpu {
						sound-dai = <0xffffffff>;
					};

					platform {
						sound-dai = <0xffffffff>;
					};

					codec {
						sound-dai = <0xf>;
					};
				};

				rdma6 {

					cpu {
						sound-dai = <0xffffffff>;
					};

					platform {
						sound-dai = <0xffffffff>;
					};

					codec {
						sound-dai = <0xf>;
					};
				};

				rdma7 {

					cpu {
						sound-dai = <0xffffffff>;
					};

					platform {
						sound-dai = <0xffffffff>;
					};

					codec {
						sound-dai = <0xf>;
					};
				};

				rdma8 {

					cpu {
						sound-dai = <0xffffffff>;
					};

					platform {
						sound-dai = <0xffffffff>;
					};

					codec {
						sound-dai = <0xf>;
					};
				};

				rdma9 {

					cpu {
						sound-dai = <0xffffffff>;
					};

					platform {
						sound-dai = <0xffffffff>;
					};

					codec {
						sound-dai = <0xf>;
					};
				};

				rdma10 {

					cpu {
						sound-dai = <0xffffffff>;
					};

					platform {
						sound-dai = <0xffffffff>;
					};

					codec {
						sound-dai = <0xf>;
					};
				};

				rdma11 {

					cpu {
						sound-dai = <0xffffffff>;
					};

					platform {
						sound-dai = <0xffffffff>;
					};

					codec {
						sound-dai = <0xf>;
					};
				};

				wdma0 {

					cpu {
						sound-dai = <0xffffffff>;
					};

					platform {
						sound-dai = <0xffffffff>;
					};

					codec {
						sound-dai = <0xf>;
					};
				};

				wdma1 {

					cpu {
						sound-dai = <0xffffffff>;
					};

					platform {
						sound-dai = <0xffffffff>;
					};

					codec {
						sound-dai = <0xf>;
					};
				};

				wdma2 {

					cpu {
						sound-dai = <0xffffffff>;
					};

					platform {
						sound-dai = <0xffffffff>;
					};

					codec {
						sound-dai = <0xf>;
					};
				};

				wdma3 {

					cpu {
						sound-dai = <0xffffffff>;
					};

					platform {
						sound-dai = <0xffffffff>;
					};

					codec {
						sound-dai = <0xf>;
					};
				};

				wdma4 {

					cpu {
						sound-dai = <0xffffffff>;
					};

					platform {
						sound-dai = <0xffffffff>;
					};

					codec {
						sound-dai = <0xf>;
					};
				};

				wdma5 {

					cpu {
						sound-dai = <0xffffffff>;
					};

					platform {
						sound-dai = <0xffffffff>;
					};

					codec {
						sound-dai = <0xf>;
					};
				};

				wdma6 {

					cpu {
						sound-dai = <0xffffffff>;
					};

					platform {
						sound-dai = <0xffffffff>;
					};

					codec {
						sound-dai = <0xf>;
					};
				};

				wdma7 {

					cpu {
						sound-dai = <0xffffffff>;
					};

					platform {
						sound-dai = <0xffffffff>;
					};

					codec {
						sound-dai = <0xf>;
					};
				};

				vts0 {

					cpu {
						sound-dai = <0xffffffff 0x0>;
					};

					codec {
						sound-dai = <0xf>;
					};
				};

				vts1 {

					cpu {
						sound-dai = <0xffffffff 0x1>;
					};

					codec {
						sound-dai = <0xf>;
					};
				};

				uaif0 {
					format = "i2s";

					cpu {
						sound-dai = <0xffffffff>;
					};

					codec {
						sound-dai = <0x10 0x0>;
					};
				};

				uaif1 {
					format = "i2s";

					cpu {
						sound-dai = <0xffffffff>;
					};

					codec {
						sound-dai = <0x11 0x0>;
					};
				};

				uaif2 {
					format = "i2s";

					cpu {
						sound-dai = <0xffffffff>;
					};

					codec {
						sound-dai = <0x10 0x2>;
					};
				};

				uaif3 {
					format = "i2s";

					cpu {
						sound-dai = <0xffffffff>;
					};

					codec {
						sound-dai = <0xf>;
					};
				};

				dsif0 {
					format = "pdm";

					cpu {
						sound-dai = <0xffffffff>;
					};

					codec {
						sound-dai = <0xf>;
					};
				};

				sifs0 {

					cpu {
						sound-dai = <0xffffffff 0x0>;
					};

					codec {
						sound-dai = <0xf>;
					};
				};

				sifs1 {

					cpu {
						sound-dai = <0xffffffff 0x1>;
					};

					codec {
						sound-dai = <0xf>;
					};
				};

				sifs2 {

					cpu {
						sound-dai = <0xffffffff 0x2>;
					};

					codec {
						sound-dai = <0xf>;
					};
				};

				sifs3 {

					cpu {
						sound-dai = <0xffffffff 0x3>;
					};

					codec {
						sound-dai = <0xf>;
					};
				};

				sifs4 {

					cpu {
						sound-dai = <0xffffffff 0x4>;
					};

					codec {
						sound-dai = <0xf>;
					};
				};

				rsrc0 {

					cpu {
						sound-dai = <0xffffffff 0x5>;
					};

					codec {
						sound-dai = <0xf>;
					};
				};

				rsrc1 {

					cpu {
						sound-dai = <0xffffffff 0x6>;
					};

					codec {
						sound-dai = <0xf>;
					};
				};

				nsrc0 {

					cpu {
						sound-dai = <0xffffffff 0x7>;
					};

					codec {
						sound-dai = <0xf>;
					};
				};

				nsrc1 {

					cpu {
						sound-dai = <0xffffffff 0x8>;
					};

					codec {
						sound-dai = <0xf>;
					};
				};

				nsrc2 {

					cpu {
						sound-dai = <0xffffffff 0x9>;
					};

					codec {
						sound-dai = <0xf>;
					};
				};

				nsrc3 {

					cpu {
						sound-dai = <0xffffffff 0xa>;
					};

					codec {
						sound-dai = <0xf>;
					};
				};

				nsrc4 {

					cpu {
						sound-dai = <0xffffffff 0xb>;
					};

					codec {
						sound-dai = <0xf>;
					};
				};

				nsrc5 {

					cpu {
						sound-dai = <0xffffffff 0xc>;
					};

					codec {
						sound-dai = <0xf>;
					};
				};

				nsrc6 {

					cpu {
						sound-dai = <0xffffffff 0xd>;
					};

					codec {
						sound-dai = <0xf>;
					};
				};

				debug-trace@1 {

					cpu {
						sound-dai = <0x10 0x6>;
					};

					codec {
						sound-dai = <0x10 0x7>;
					};
				};
			};
		};
	};

	fragment@11 {
		target = <0xffffffff>;

		__overlay__ {
		};
	};

	fragment@12 {
		target = <0xffffffff>;

		__overlay__ {
			#address-cells = <0x2>;
			#size-cells = <0x1>;

			cp_linear {
				compatible = "exynos,cp_linear";
				reg = <0x0 0xf0000000 0xd900000>;
			};
		};
	};

	fragment@13 {
		target = <0xffffffff>;

		__overlay__ {
			interactive_info = <0x3f7a0 0x5e 0x0>;
			gpu_dvfs_table_size = <0x9 0x8>;
			gpu_dvfs_table = <0xab630 0x4e 0x64 0x9 0x1fefc8 0x163780 0x0 0x1bc560 0x9eb10 0x4e 0x62 0x5 0x1fefc8 0x163780 0x0 0x1fbd00 0x8ba60 0x4e 0x62 0x5 0x1b5fd0 0x0 0x0 0x0 0x69b68 0x4e 0x5f 0x1 0x14a140 0x0 0x0 0x0 0x5c0a8 0x4e 0x5a 0x1 0x14a140 0x0 0x0 0x0 0x4f588 0x4e 0x55 0x1 0xf78f0 0x0 0x0 0x0 0x3f7a0 0x4e 0x55 0x1 0xa50a0 0x0 0x0 0x0 0x30d40 0x4e 0x55 0x1 0xa50a0 0x0 0x0 0x0 0x26160 0x0 0x55 0x1 0xa50a0 0x0 0x0 0x0>;
			gpu_max_clock = <0xab630>;
			gpu_max_clock_limit = <0xab630>;
			gpu_min_clock = <0x26160>;
			gpu_dvfs_start_clock = <0x3f7a0>;
			gpu_dvfs_bl_config_clock = <0x26160>;
		};
	};

	fragment@14 {
		target = <0xffffffff>;

		__overlay__ {
			#address-cells = <0x1>;
			#size-cells = <0x0>;
			status = "okay";
			num-slots = <0x1>;
			supports-4bit;
			supports-cmd23;
			supports-erase;
			supports-highspeed;
			sd-uhs-sdr50;
			sd-uhs-sdr104;
			card-detect-gpio;
			bypass-for-allpass;
			use-fine-tuning;
			card-init-hwacg-ctrl;
			skip-init-mmc-scan;
			qos-dvfs-level = <0x61a80>;
			fifo-depth = <0x40>;
			desc-size = <0x4>;
			card-detect-delay = <0xc8>;
			samsung,dw-mshc-ciu-div = <0x3>;
			clock-frequency = <0x2faf0800>;
			samsung,dw-mshc-sdr-timing = <0x3 0x0 0x2 0x0>;
			samsung,dw-mshc-ddr-timing = <0x3 0x0 0x2 0x1>;
			samsung,dw-mshc-sdr50-timing = <0x3 0x0 0x4 0x2>;
			samsung,dw-mshc-sdr104-timing = <0x3 0x0 0x3 0x0>;
			num-ref-clks = <0x9>;
			ciu_clkin = <0x19 0x32 0x32 0x19 0x32 0x64 0xc8 0x32 0x32>;
			clk-drive-number = <0x6>;
			pinctrl-names = "default", "fast-slew-rate-1x", "fast-slew-rate-1_5x", "fast-slew-rate-2x", "fast-slew-rate-2_5x", "fast-slew-rate-3x", "fast-slew-rate-4x", "pins-as-pdn", "pins-as-func";
			pinctrl-0 = <0xffffffff 0xffffffff 0xffffffff 0xffffffff 0x12>;
			pinctrl-1 = <0xffffffff>;
			pinctrl-2 = <0xffffffff>;
			pinctrl-3 = <0xffffffff>;
			pinctrl-4 = <0xffffffff>;
			pinctrl-5 = <0xffffffff>;
			pinctrl-6 = <0xffffffff>;
			pinctrl-7 = <0xffffffff>;
			pinctrl-8 = <0xffffffff 0xffffffff 0xffffffff 0xffffffff>;
			card-detect = <0xffffffff 0x0 0xf>;

			slot@0 {
				reg = <0x0>;
				bus-width = <0x4>;
				disable-wp;
			};
		};
	};

	fragment@15 {
		target = <0xffffffff>;

		__overlay__ {
			status = "okay";
		};
	};

	fragment@16 {
		target = <0xffffffff>;

		__overlay__ {

			key-home {
				samsung,pins = "gpa3-7";
				samsung,pin-function = <0xf>;
				samsung,pin-pud = <0x0>;
				samsung,pin-drv = <0x0>;
				linux,phandle = <0xb>;
				phandle = <0xb>;
			};

			key-voldown {
				samsung,pins = "gpa2-1";
				samsung,pin-function = <0xf>;
				samsung,pin-pud = <0x0>;
				samsung,pin-drv = <0x0>;
				linux,phandle = <0xc>;
				phandle = <0xc>;
			};

			key-volup {
				samsung,pins = "gpa2-0";
				samsung,pin-function = <0xf>;
				samsung,pin-pud = <0x0>;
				samsung,pin-drv = <0x0>;
				linux,phandle = <0xd>;
				phandle = <0xd>;
			};

			key-power {
				samsung,pins = "gpa3-3";
				samsung,pin-function = <0xf>;
				linux,phandle = <0xe>;
				phandle = <0xe>;
			};

			dwmmc2_cd_ext_irq {
				samsung,pins = "gpa0-0";
				samsung,pin-function = <0xf>;
				samsung,pin-pud = <0x3>;
				samsung,pin-drv = <0x4>;
				linux,phandle = <0x12>;
				phandle = <0x12>;
			};

			m-pmic-irq {
				samsung,pins = "gpa0-2";
				samsung,pin-pud = <0x3>;
				samsung,pin-drv = <0x3>;
				linux,phandle = <0x1c>;
				phandle = <0x1c>;
			};

			s-pmic-irq {
				samsung,pins = "gpa0-4";
				samsung,pin-pud = <0x3>;
				samsung,pin-drv = <0x3>;
				linux,phandle = <0x1d>;
				phandle = <0x1d>;
			};

			sub-pmic-irq {
				samsung,pins = "gpa0-6";
				samsung,pin-function = <0x0>;
				samsung,pin-pud = <0x0>;
				samsung,pin-drv = <0x0>;
				linux,phandle = <0x1e>;
				phandle = <0x1e>;
			};

			if-pmic-irq {
				samsung,pins = "gpa1-6";
				samsung,pin-function = <0x0>;
				samsung,pin-pud = <0x0>;
				samsung,pin-drv = <0x0>;
				linux,phandle = <0x19>;
				phandle = <0x19>;
			};

			fuel-irq {
				samsung,pins = "gpa1-5";
				samsung,pin-function = <0x0>;
				samsung,pin-pud = <0x0>;
				samsung,pin-drv = <0x0>;
				linux,phandle = <0x1a>;
				phandle = <0x1a>;
			};

			usbpd-irq {
				samsung,pins = "gpa3-2";
				samsung,pin-function = <0xf>;
				samsung,pin-pud = <0x0>;
				samsung,pin-drv = <0x0>;
				linux,phandle = <0x1b>;
				phandle = <0x1b>;
			};
		};
	};

	fragment@17 {
		target = <0xffffffff>;

		__overlay__ {
			exynos,block-type = "sda";
			exynos,fips-block_offset = <0x5>;
		};
	};

	fragment@18 {
		target = <0xffffffff>;

		__overlay__ {
			lcd_info = <0x13>;
			gpios = <0xffffffff 0x6 0x1 0xffffffff 0x2 0x1>;
		};
	};

	fragment@19 {
		target = <0xffffffff>;

		__overlay__ {
			usi_v2_mode = "i2c";
			status = "okay";
		};
	};

	fragment@20 {
		target = <0xffffffff>;

		__overlay__ {
			status = "disabled";
		};
	};

	fragment@21 {
		target = <0xffffffff>;

		__overlay__ {
			usi_v2_mode = "i2c";
			status = "okay";
		};
	};

	fragment@22 {
		target = <0xffffffff>;

		__overlay__ {
			usi_v2_mode = "i2c";
			status = "okay";
		};
	};

	fragment@23 {
		target = <0xffffffff>;

		__overlay__ {
			usi_v2_mode = "spi";
			status = "okay";
		};
	};

	fragment@24 {
		target = <0xffffffff>;

		__overlay__ {
			usi_v2_mode = "spi";
			status = "okay";
		};
	};

	fragment@25 {
		target = <0xffffffff>;

		__overlay__ {
			usi_v2_mode = "spi";
			status = "okay";
		};
	};

	fragment@26 {
		target = <0xffffffff>;

		__overlay__ {
			status = "disabled";
		};
	};

	fragment@27 {
		target = <0xffffffff>;

		__overlay__ {
			usi_v2_mode = "i2c";
			status = "okay";
		};
	};

	fragment@28 {
		target = <0xffffffff>;

		__overlay__ {
			usi_v2_mode = "i2c";
			status = "okay";
		};
	};

	fragment@29 {
		target = <0xffffffff>;

		__overlay__ {
			usi_v2_mode = "i2c";
			status = "okay";
		};
	};

	fragment@30 {
		target = <0xffffffff>;

		__overlay__ {
			status = "disabled";
		};
	};

	fragment@31 {
		target = <0xffffffff>;

		__overlay__ {
			status = "disabled";
		};
	};

	fragment@32 {
		target = <0xffffffff>;

		__overlay__ {
			status = "disabled";
		};
	};

	fragment@33 {
		target = <0xffffffff>;

		__overlay__ {
			status = "disabled";
		};
	};

	fragment@34 {
		target = <0xffffffff>;

		__overlay__ {
			status = "disabled";
		};
	};

	fragment@35 {
		target = <0xffffffff>;

		__overlay__ {
			usi_v2_mode = "spi";
			status = "okay";
		};
	};

	fragment@36 {
		target = <0xffffffff>;

		__overlay__ {
			usi_v2_mode = "i2c";
			status = "okay";
		};
	};

	fragment@37 {
		target = <0xffffffff>;

		__overlay__ {
			status = "disabled";
		};
	};

	fragment@38 {
		target = <0xffffffff>;

		__overlay__ {
			status = "disabled";
		};
	};

	fragment@39 {
		target = <0xffffffff>;

		__overlay__ {
			status = "disabled";
		};
	};

	fragment@40 {
		target = <0xffffffff>;

		__overlay__ {
			status = "disabled";
		};
	};

	fragment@41 {
		target = <0xffffffff>;

		__overlay__ {

			phy-port {
				samsung,pins = "gpp4-5";
				samsung,pin-function = <0x0>;
				samsung,pin-pud = <0x3>;
				samsung,pin-drv = <0x0>;
				linux,phandle = <0x14>;
				phandle = <0x14>;
			};
		};
	};

	fragment@42 {
		target = <0xffffffff>;

		__overlay__ {
			status = "okay";
		};
	};

	fragment@43 {
		target = <0xffffffff>;

		__overlay__ {
			dr_mode = "otg";
			maximum-speed = "super-speed-plus";
			snps,quirk-frame-length-adjustment = <0x20>;
			snps,u1u2_exitfail_quirk;
			snps,ux_exit_in_px_quirk;
			snps,elastic_buf_mode_quirk;
			snps,dis-u2-freeclk-exists-quirk;
		};
	};

	fragment@44 {
		target = <0xffffffff>;

		__overlay__ {
			status = "okay";
			pinctrl-names = "default";
			pinctrl-0 = <0x14>;
			phy,gpio_phy_port = <0xffffffff 0x5 0x0>;
			hs_tune_param = <0x15>;
			ss_tune_param = <0x16>;
		};
	};

	fragment@45 {
		target = <0xffffffff>;

		__overlay__ {

			attn-irq {
				samsung,pins = "gpg2-0";
				samsung,pin-function = <0xf>;
				samsung,pin-pud = <0x0>;
				samsung,pin-drv = <0x0>;
				linux,phandle = <0x17>;
				phandle = <0x17>;
			};

			attn-input {
				samsung,pins = "gpg2-0";
				samsung,pin-function = <0x0>;
				samsung,pin-pud = <0x1>;
				linux,phandle = <0x18>;
				phandle = <0x18>;
			};

			codec-reset {
				samsung,pins = "gpg2-4";
				samsung,pin-con-pdn = <0x3>;
				samsung,pin-pud-pdn = <0x1>;
				linux,phandle = <0x21>;
				phandle = <0x21>;
			};
		};
	};

	fragment@46 {
		target = <0xffffffff>;

		__overlay__ {
			#address-cells = <0x1>;
			#size-cells = <0x0>;
			status = "okay";
			samsung,reset-before-trans;

			touchscreen@48 {
				compatible = "sec,sec_ts";
				reg = <0x48>;
				pinctrl-names = "on_state", "off_state";
				pinctrl-0 = <0x17>;
				pinctrl-1 = <0x18>;
				sec,irq_gpio = <0xffffffff 0x0 0x0>;
				sec,irq_type = <0x2008>;
				sec,num_lines = <0x21 0x10>;
				sec,max_coords = <0xfff 0xfff>;
				sec,grip_area = <0x200>;
				sec,regulator_dvdd = "S2MPB02_LDO6";
				sec,regulator_avdd = "S2MPB02_LDO18";
				sec,project_name = "kangchen", "universal8895";
				sec,firmware_name = "tsp_sec/y761_dream1.fw";
			};
		};
	};

	fragment@47 {
		target = <0xffffffff>;

		__overlay__ {
			#address-cells = <0x1>;
			#size-cells = <0x0>;
			status = "okay";

			s2mu004@3d {
				compatible = "samsung,s2mu004mfd";
				reg = <0x3d>;
				pinctrl-names = "default";
				pinctrl-0 = <0x19>;
				s2mu004,irq-gpio = <0xffffffff 0x6 0x0>;
				s2mu004,wakeup;
			};

			muic {
				status = "okay";
				muic,uart_addr = "11850000.pinctrl";
				muic,uart_rxd = "gpp3-2";
				muic,uart_txd = "gpp3-p";
			};

			s2mu004-charger {
				status = "okay";
				battery,charger_name = "s2mu004-charger";
				battery,chg_gpio_en = <0x0>;
				battery,chg_polarity_en = <0x0>;
				battery,chg_gpio_status = <0x0>;
				battery,chg_polarity_status = <0x0>;
				battery,chg_float_voltage = <0x10fe>;
				battery,chg_recharge_vcell = <0x109a>;
				battery,chg_full_vcell = <0x10cc>;
				battery,full_check_type = <0x2>;
				battery,full_check_type_2nd = <0x2>;
				battery,input_current_limit = <0x708 0x1c2 0x1c2 0x708 0x1f4 0x384 0x5dc 0x1c2 0x3e8 0x1c2 0x384 0x384 0x384 0x76c 0x708 0x1c2 0x1c2 0x190 0x2bc 0x514 0x12c 0x3e8 0x5dc 0x1c2 0x672 0x834 0x1f4 0x672 0x50 0x708 0x672 0x578 0x3e8 0x3e8 0x2bc 0x384 0x384 0x384 0x1f4 0x708 0x672 0xbb8>;
				battery,fast_charging_current = <0x834 0x1c2 0x1c2 0x834 0x320 0x4b0 0x5dc 0x1c2 0x4b0 0x1c2 0x834 0x834 0x834 0x640 0x834 0x1c2 0x1c2 0x190 0x2bc 0x514 0x12c 0x3e8 0x5dc 0x1c2 0x960 0xdac 0x1f4 0x960 0x50 0x708 0x3e8 0x578 0x1c2 0x3e8 0x834 0x834 0x834 0x834 0x1c2 0x834 0x960 0xbb8>;
				battery,full_check_current_1st = <0x12c 0x0 0x0 0x12c 0x12c 0x12c 0x12c 0x12c 0x12c 0x0 0x12c 0x12c 0x12c 0x12c 0x12c 0x0 0x0 0x12c 0x12c 0x12c 0x12c 0x12c 0x12c 0x0 0x12c 0x12c 0x12c 0x12c 0x0 0x12c 0x12c 0x12c 0x0 0x12c 0x12c 0x12c 0x12c 0x12c 0x12c 0x12c 0x12c 0x12c>;
				battery,full_check_current_2nd = <0x64 0x0 0x0 0x64 0x64 0x64 0x64 0x64 0x64 0x0 0x64 0x64 0x64 0x64 0x64 0x0 0x0 0x64 0x64 0x64 0x64 0x64 0x64 0x0 0x64 0x64 0x64 0x64 0x0 0x64 0x64 0x64 0x0 0x64 0x64 0x64 0x64 0x64 0x64 0x64 0x64 0x64>;
			};
		};
	};

	fragment@48 {
		target = <0xffffffff>;

		__overlay__ {
			#address-cells = <0x1>;
			#size-cells = <0x0>;
			status = "okay";

			s2mu004-fuelgauge@3B {
				compatible = "samsung,s2mu004-fuelgauge";
				reg = <0x3b>;
				pinctrl-names = "default";
				pinctrl-0 = <0x1a>;
				fuelgauge,fuel_int = <0xffffffff 0x5 0x0>;
				fuelgauge,fuel_alert_soc = <0x1>;
				fuelgauge,capacity_max = <0x3e8>;
				fuelgauge,capacity_max_margin = <0x46>;
				fuelgauge,capacity_min = <0x0>;
				fuelgauge,capacity_calculation_type = <0x1c>;
				fuelgauge,type_str = "SDI";
				fuelgauge,model_type = <0x1>;
			};
		};
	};

	fragment@49 {
		target = <0xffffffff>;

		__overlay__ {
			#address-cells = <0x1>;
			#size-cells = <0x0>;
			status = "okay";

			usbpd-s2mm005@33 {
				compatible = "sec-s2mm005,i2c";
				reg = <0x33>;
				pinctrl-names = "default";
				pinctrl-0 = <0x1b>;
				interrupt-parent = <0xffffffff>;
				usbpd,usbpd_int = <0xffffffff 0x2 0x0>;
			};

			usbpd-manager {
				pdic,max_power = <0x1388>;
				pdic,op_power = <0x9c4>;
				pdic,max_voltage = <0x2328>;
				pdic,max_current = <0x7d0>;
				pdic,min_current = <0x1f4>;
				pdic,giveback = <0x0>;
				pdic,usb_com_capable = <0x1>;
				pdic,no_usb_suspend = <0x1>;
				source,max_voltage = <0x1388>;
				source,min_voltage = <0xfa0>;
				source,max_power = <0x9c4>;
				sink,capable_max_voltage = <0x2328>;
			};
		};
	};

	fragment@50 {
		target = <0xffffffff>;

		__overlay__ {
			#address-cells = <0x1>;
			#size-cells = <0x0>;
			status = "okay";

			s2mps19mfd@00 {
				compatible = "samsung,s2mps19mfd";
				acpm-ipc-channel = <0x2>;
				acpm-speedy-channel = <0x0>;
				i2c-speedy-address;
				s2mps19,wakeup = "enabled";
				s2mps19,irq-gpio = <0xffffffff 0x2 0x0>;
				reg = <0x0>;
				interrupts = <0x2 0x0 0x0>;
				interrupt-parent = <0xffffffff>;
				pinctrl-names = "default";
				pinctrl-0 = <0x1c 0xffffffff>;
				gpios = <0xffffffff 0x4 0x0>;
				smpl_warn_en = <0x1>;
				smpl_warn_vth = <0x80>;
				smpl_warn_hys = <0x0>;
				adc_mode = <0x1>;
				adc_sync_mode = <0x2>;
				ocp_warn1_en = <0x1>;
				ocp_warn1_cnt = <0x0>;
				ocp_warn1_dvs_mask = <0x0>;
				ocp_warn1_lv = <0x0>;
				ocp_warn2_en = <0x0>;
				ocp_warn2_cnt = <0x0>;
				ocp_warn2_dvs_mask = <0x0>;
				ocp_warn2_lv = <0x0>;
				wtsr_en = "enabled";
				smpl_en = "enabled";
				wtsr_timer_val = <0x3>;
				smpl_timer_val = <0x4>;
				sub_smpl_en = "enabled";
				check_jigon = <0x0>;
				init_time,sec = <0x0>;
				init_time,min = <0x0>;
				init_time,hour = <0xc>;
				init_time,mday = <0x1>;
				init_time,mon = <0x0>;
				init_time,year = <0x75>;
				init_time,wday = <0x0>;

				regulators {

					BUCK1M {
						regulator-name = "m_vdd_buck1";
						regulator-min-microvolt = <0x6ddd0>;
						regulator-max-microvolt = <0x10c8e0>;
						regulator-always-on;
						regulator-ramp-delay = <0x1770>;
						regulator-initial-mode = <0x2>;
						linux,phandle = <0x30>;
						phandle = <0x30>;
					};

					BUCK2M {
						regulator-name = "m_vdd_buck2";
						regulator-min-microvolt = <0x6ddd0>;
						regulator-max-microvolt = <0x13d620>;
						regulator-always-on;
						regulator-ramp-delay = <0x1770>;
						regulator-initial-mode = <0x2>;
						linux,phandle = <0x31>;
						phandle = <0x31>;
					};

					BUCK3M {
						regulator-name = "m_vdd_buck3";
						regulator-min-microvolt = <0x6ddd0>;
						regulator-max-microvolt = <0x13d620>;
						regulator-always-on;
						regulator-ramp-delay = <0x1770>;
						regulator-initial-mode = <0x1>;
						linux,phandle = <0x32>;
						phandle = <0x32>;
					};

					BUCK4M {
						regulator-name = "m_vdd_buck4";
						regulator-min-microvolt = <0x6ddd0>;
						regulator-max-microvolt = <0x13d620>;
						regulator-always-on;
						regulator-ramp-delay = <0x1770>;
						regulator-initial-mode = <0x1>;
						linux,phandle = <0x33>;
						phandle = <0x33>;
					};

					BUCK5M {
						regulator-name = "m_vdd_buck5";
						regulator-min-microvolt = <0x6ddd0>;
						regulator-max-microvolt = <0xe7ef0>;
						regulator-always-on;
						regulator-ramp-delay = <0x1770>;
						regulator-initial-mode = <0x2>;
						linux,phandle = <0x34>;
						phandle = <0x34>;
					};

					BUCK6M {
						regulator-name = "m_vdd_buck6";
						regulator-min-microvolt = <0x6ddd0>;
						regulator-max-microvolt = <0x10c8e0>;
						regulator-always-on;
						regulator-ramp-delay = <0x1770>;
						regulator-initial-mode = <0x2>;
						linux,phandle = <0x35>;
						phandle = <0x35>;
					};

					BUCK7M {
						regulator-name = "m_vdd_buck7";
						regulator-min-microvolt = <0x6ddd0>;
						regulator-max-microvolt = <0x13d620>;
						regulator-always-on;
						regulator-ramp-delay = <0x1770>;
						regulator-initial-mode = <0x2>;
						linux,phandle = <0x36>;
						phandle = <0x36>;
					};

					BUCK8M {
						regulator-name = "m_vdd_buck8";
						regulator-min-microvolt = <0x6ddd0>;
						regulator-max-microvolt = <0xe7ef0>;
						regulator-always-on;
						regulator-ramp-delay = <0x1770>;
						regulator-initial-mode = <0x2>;
						linux,phandle = <0x37>;
						phandle = <0x37>;
					};

					BUCK9M {
						regulator-name = "m_vdd_buck9";
						regulator-min-microvolt = <0xb71b0>;
						regulator-max-microvolt = <0x118c30>;
						regulator-always-on;
						regulator-ramp-delay = <0x1770>;
						regulator-initial-mode = <0x3>;
						linux,phandle = <0x38>;
						phandle = <0x38>;
					};

					BUCK10M {
						regulator-name = "m_vdd_buck10";
						regulator-min-microvolt = <0xdbba0>;
						regulator-max-microvolt = <0x13d620>;
						regulator-always-on;
						regulator-ramp-delay = <0x1770>;
						regulator-initial-mode = <0x3>;
						linux,phandle = <0x39>;
						phandle = <0x39>;
					};

					BUCK11M {
						regulator-name = "m_vdd_buck11";
						regulator-min-microvolt = <0x10c8e0>;
						regulator-max-microvolt = <0x16e360>;
						regulator-always-on;
						regulator-ramp-delay = <0x1770>;
						regulator-initial-mode = <0x3>;
						linux,phandle = <0x3a>;
						phandle = <0x3a>;
					};

					BUCK12M {
						regulator-name = "m_vdd_buck12";
						regulator-min-microvolt = <0x19f0a0>;
						regulator-max-microvolt = <0x20ce70>;
						regulator-always-on;
						regulator-ramp-delay = <0x1770>;
						regulator-initial-mode = <0x3>;
						linux,phandle = <0x3b>;
						phandle = <0x3b>;
					};

					LDO1M {
						regulator-name = "m_vdd_ldo1";
						regulator-min-microvolt = <0xaae60>;
						regulator-max-microvolt = <0xe7ef0>;
						regulator-always-on;
						regulator-ramp-delay = <0x2ee0>;
						regulator-initial-mode = <0x3>;
						linux,phandle = <0x3c>;
						phandle = <0x3c>;
					};

					LDO2M {
						regulator-name = "vqmmc";
						regulator-min-microvolt = <0x19f0a0>;
						regulator-max-microvolt = <0x325aa0>;
						regulator-ramp-delay = <0x2ee0>;
						regulator-initial-mode = <0x3>;
						linux,phandle = <0x3d>;
						phandle = <0x3d>;
					};

					LDO3M {
						regulator-name = "m_vdd_ldo3";
						regulator-min-microvolt = <0xaae60>;
						regulator-max-microvolt = <0x10c8e0>;
						regulator-always-on;
						regulator-ramp-delay = <0x2ee0>;
						regulator-initial-mode = <0x1>;
						linux,phandle = <0x3e>;
						phandle = <0x3e>;
					};

					LDO4M {
						regulator-name = "m_vdd_ldo4";
						regulator-min-microvolt = <0x186a00>;
						regulator-max-microvolt = <0x1dc130>;
						regulator-always-on;
						regulator-ramp-delay = <0x2ee0>;
						regulator-initial-mode = <0x1>;
						linux,phandle = <0x3f>;
						phandle = <0x3f>;
					};

					LDO5M {
						regulator-name = "m_vdd_ldo5";
						regulator-min-microvolt = <0x6ddd0>;
						regulator-max-microvolt = <0x10c8e0>;
						regulator-always-on;
						regulator-ramp-delay = <0x2ee0>;
						regulator-initial-mode = <0x1>;
						linux,phandle = <0x40>;
						phandle = <0x40>;
					};

					LDO6M {
						regulator-name = "m_vdd_ldo6";
						regulator-min-microvolt = <0x6ddd0>;
						regulator-max-microvolt = <0xe7ef0>;
						regulator-always-on;
						regulator-ramp-delay = <0x2ee0>;
						regulator-initial-mode = <0x1>;
						linux,phandle = <0x41>;
						phandle = <0x41>;
					};

					LDO7M {
						regulator-name = "m_vdd_ldo7";
						regulator-min-microvolt = <0x6ddd0>;
						regulator-max-microvolt = <0x10c8e0>;
						regulator-always-on;
						regulator-ramp-delay = <0x2ee0>;
						regulator-initial-mode = <0x1>;
						linux,phandle = <0x42>;
						phandle = <0x42>;
					};

					LDO8M {
						regulator-name = "m_vdd_ldo8";
						regulator-min-microvolt = <0x6ddd0>;
						regulator-max-microvolt = <0x13d620>;
						regulator-always-on;
						regulator-ramp-delay = <0x2ee0>;
						regulator-initial-mode = <0x1>;
						linux,phandle = <0x43>;
						phandle = <0x43>;
					};

					LDO9M {
						regulator-name = "m_vdd_ldo9";
						regulator-min-microvolt = <0xaae60>;
						regulator-max-microvolt = <0x13d620>;
						regulator-always-on;
						regulator-ramp-delay = <0x2ee0>;
						regulator-initial-mode = <0x1>;
						linux,phandle = <0x44>;
						phandle = <0x44>;
					};

					LDO10M {
						regulator-name = "m_vdd_ldo10";
						regulator-min-microvolt = <0xaae60>;
						regulator-max-microvolt = <0x10c8e0>;
						regulator-boot-on;
						regulator-ramp-delay = <0x2ee0>;
						regulator-initial-mode = <0x3>;
						linux,phandle = <0x45>;
						phandle = <0x45>;
					};

					LDO11M {
						regulator-name = "m_vdd_ldo11";
						regulator-min-microvolt = <0x186a00>;
						regulator-max-microvolt = <0x1dc130>;
						regulator-boot-on;
						regulator-ramp-delay = <0x2ee0>;
						regulator-initial-mode = <0x3>;
						linux,phandle = <0x46>;
						phandle = <0x46>;
					};

					LDO12M {
						regulator-name = "m_vdd_ldo12";
						regulator-min-microvolt = <0x19f0a0>;
						regulator-max-microvolt = <0x331df0>;
						regulator-boot-on;
						regulator-ramp-delay = <0x2ee0>;
						regulator-initial-mode = <0x3>;
						linux,phandle = <0x47>;
						phandle = <0x47>;
					};

					LDO15M {
						regulator-name = "vmmc";
						regulator-min-microvolt = <0x2625a0>;
						regulator-max-microvolt = <0x325aa0>;
						regulator-ramp-delay = <0x2ee0>;
						regulator-initial-mode = <0x3>;
						linux,phandle = <0x48>;
						phandle = <0x48>;
					};

					LDO16M {
						regulator-name = "m_vdd_ldo16";
						regulator-min-microvolt = <0x2625a0>;
						regulator-max-microvolt = <0x325aa0>;
						regulator-always-on;
						regulator-ramp-delay = <0x2ee0>;
						regulator-initial-mode = <0x3>;
						linux,phandle = <0x49>;
						phandle = <0x49>;
					};

					LDO17M {
						regulator-name = "m_vdd_ldo17";
						regulator-min-microvolt = <0x186a00>;
						regulator-max-microvolt = <0x2191c0>;
						regulator-always-on;
						regulator-ramp-delay = <0x2ee0>;
						regulator-initial-mode = <0x3>;
						linux,phandle = <0x1f>;
						phandle = <0x1f>;
					};

					LDO18M {
						regulator-name = "m_vdd_ldo18";
						regulator-min-microvolt = <0xaae60>;
						regulator-max-microvolt = <0x124f80>;
						regulator-ramp-delay = <0x2ee0>;
						regulator-initial-mode = <0x3>;
						linux,phandle = <0x20>;
						phandle = <0x20>;
					};

					LDO19M {
						regulator-name = "m_vdd_ldo19";
						regulator-min-microvolt = <0x186a00>;
						regulator-max-microvolt = <0x2191c0>;
						regulator-always-on;
						regulator-ramp-delay = <0x2ee0>;
						regulator-initial-mode = <0x3>;
						linux,phandle = <0x4a>;
						phandle = <0x4a>;
					};

					LDO20M {
						regulator-name = "m_vdd_ldo20";
						regulator-min-microvolt = <0x2625a0>;
						regulator-max-microvolt = <0x325aa0>;
						regulator-always-on;
						regulator-ramp-delay = <0x2ee0>;
						regulator-initial-mode = <0x3>;
						linux,phandle = <0x4b>;
						phandle = <0x4b>;
					};

					LDO21M {
						regulator-name = "VDDIO_1.8V_SUB";
						regulator-min-microvolt = <0x186a00>;
						regulator-max-microvolt = <0x2191c0>;
						regulator-always-on;
						regulator-ramp-delay = <0x2ee0>;
						regulator-initial-mode = <0x3>;
						linux,phandle = <0x4c>;
						phandle = <0x4c>;
					};

					LDO22M {
						regulator-name = "m_vdd_ldo22";
						regulator-min-microvolt = <0x186a00>;
						regulator-max-microvolt = <0x2191c0>;
						regulator-always-on;
						regulator-ramp-delay = <0x2ee0>;
						regulator-initial-mode = <0x3>;
						linux,phandle = <0x4d>;
						phandle = <0x4d>;
					};

					LDO23M {
						regulator-name = "VDD12_CAM_CORE";
						regulator-min-microvolt = <0xaae60>;
						regulator-max-microvolt = <0x124f80>;
						regulator-always-on;
						regulator-ramp-delay = <0x2ee0>;
						regulator-initial-mode = <0x3>;
						linux,phandle = <0x4e>;
						phandle = <0x4e>;
					};

					LDO24M {
						regulator-name = "AVDD28_CAM";
						regulator-min-microvolt = <0x2625a0>;
						regulator-max-microvolt = <0x325aa0>;
						regulator-always-on;
						regulator-ramp-delay = <0x2ee0>;
						regulator-initial-mode = <0x3>;
						linux,phandle = <0x4f>;
						phandle = <0x4f>;
					};

					LDO25M {
						regulator-name = "VDD18_CAM_SENSOR_IO";
						regulator-min-microvolt = <0x186a00>;
						regulator-max-microvolt = <0x2191c0>;
						regulator-always-on;
						regulator-ramp-delay = <0x2ee0>;
						regulator-initial-mode = <0x3>;
						linux,phandle = <0x50>;
						phandle = <0x50>;
					};

					LDO26M {
						regulator-name = "m_vdd_ldo26";
						regulator-min-microvolt = <0x186a00>;
						regulator-max-microvolt = <0x2191c0>;
						regulator-always-on;
						regulator-ramp-delay = <0x2ee0>;
						regulator-initial-mode = <0x3>;
						linux,phandle = <0x51>;
						phandle = <0x51>;
					};

					LDO27M {
						regulator-name = "m_vdd_ldo27";
						regulator-min-microvolt = <0x2625a0>;
						regulator-max-microvolt = <0x325aa0>;
						regulator-always-on;
						regulator-ramp-delay = <0x2ee0>;
						regulator-initial-mode = <0x3>;
						linux,phandle = <0x52>;
						phandle = <0x52>;
					};

					LDO28M {
						regulator-name = "m_vdd_ldo28";
						regulator-min-microvolt = <0x186a00>;
						regulator-max-microvolt = <0x2191c0>;
						regulator-always-on;
						regulator-ramp-delay = <0x2ee0>;
						regulator-initial-mode = <0x3>;
						linux,phandle = <0x53>;
						phandle = <0x53>;
					};

					LDO29M {
						regulator-name = "VDDA_2.8V_SUB";
						regulator-min-microvolt = <0x2625a0>;
						regulator-max-microvolt = <0x325aa0>;
						regulator-always-on;
						regulator-ramp-delay = <0x2ee0>;
						regulator-initial-mode = <0x3>;
						linux,phandle = <0x54>;
						phandle = <0x54>;
					};
				};
			};
		};
	};

	fragment@51 {
		target = <0xffffffff>;

		__overlay__ {
			#address-cells = <0x1>;
			#size-cells = <0x0>;
			status = "okay";

			s2mps20mfd@00 {
				compatible = "samsung,s2mps20mfd";
				acpm-ipc-channel = <0x2>;
				acpm-speedy-channel = <0x1>;
				i2c-speedy-address;
				s2mps20,wakeup = "enabled";
				s2mps20,irq-gpio = <0xffffffff 0x4 0x0>;
				reg = <0x0>;
				interrupts = <0x4 0x0 0x0>;
				interrupt-parent = <0xffffffff>;
				pinctrl-names = "default";
				pinctrl-0 = <0x1d>;
				adc_mode = <0x1>;
				adc_sync_mode = <0x2>;
				ocp_warn3_en = <0x0>;
				ocp_warn3_cnt = <0x0>;
				ocp_warn3_dvs_mask = <0x0>;
				ocp_warn3_lv = <0x0>;

				regulators {

					BUCK1S {
						regulator-name = "s_vdd_buck1";
						regulator-min-microvolt = <0x6ddd0>;
						regulator-max-microvolt = <0xe7ef0>;
						regulator-always-on;
						regulator-ramp-delay = <0x1770>;
						regulator-initial-mode = <0x2>;
						linux,phandle = <0x55>;
						phandle = <0x55>;
					};

					BUCK2S {
						regulator-name = "s_vdd_buck2";
						regulator-min-microvolt = <0xdbba0>;
						regulator-max-microvolt = <0x13d620>;
						regulator-always-on;
						regulator-ramp-delay = <0x1770>;
						regulator-initial-mode = <0x3>;
						linux,phandle = <0x56>;
						phandle = <0x56>;
					};

					LDO1S {
						regulator-name = "s_vdd_ldo1";
						regulator-min-microvolt = <0x6ddd0>;
						regulator-max-microvolt = <0xe7ef0>;
						regulator-always-on;
						regulator-ramp-delay = <0x2ee0>;
						regulator-initial-mode = <0x1>;
						linux,phandle = <0x57>;
						phandle = <0x57>;
					};

					LDO2S {
						regulator-name = "s_vdd_ldo2";
						regulator-min-microvolt = <0x186a00>;
						regulator-max-microvolt = <0x1dc130>;
						regulator-always-on;
						regulator-ramp-delay = <0x2ee0>;
						regulator-initial-mode = <0x3>;
						linux,phandle = <0x58>;
						phandle = <0x58>;
					};

					LDO7S {
						regulator-name = "s_vdd_ldo7";
						regulator-min-microvolt = <0x186a00>;
						regulator-max-microvolt = <0x1dc130>;
						regulator-always-on;
						regulator-ramp-delay = <0x2ee0>;
						regulator-initial-mode = <0x3>;
						linux,phandle = <0x59>;
						phandle = <0x59>;
					};

					LDO8S {
						regulator-name = "s_vdd_ldo8";
						regulator-min-microvolt = <0xaae60>;
						regulator-max-microvolt = <0x10c8e0>;
						regulator-always-on;
						regulator-ramp-delay = <0x2ee0>;
						regulator-initial-mode = <0x3>;
						linux,phandle = <0x5a>;
						phandle = <0x5a>;
					};

					LDO9S {
						regulator-name = "s_vdd_ldo9";
						regulator-min-microvolt = <0xaae60>;
						regulator-max-microvolt = <0x10c8e0>;
						regulator-always-on;
						regulator-ramp-delay = <0x2ee0>;
						regulator-initial-mode = <0x3>;
						linux,phandle = <0x5b>;
						phandle = <0x5b>;
					};

					LDO10S {
						regulator-name = "s_vdd_ldo10";
						regulator-min-microvolt = <0x186a00>;
						regulator-max-microvolt = <0x1dc130>;
						regulator-always-on;
						regulator-ramp-delay = <0x2ee0>;
						regulator-initial-mode = <0x3>;
						linux,phandle = <0x5c>;
						phandle = <0x5c>;
					};

					LDO11S {
						regulator-name = "s_vdd_ldo11";
						regulator-min-microvolt = <0x186a00>;
						regulator-max-microvolt = <0x1dc130>;
						regulator-always-on;
						regulator-ramp-delay = <0x2ee0>;
						regulator-initial-mode = <0x3>;
						linux,phandle = <0x5d>;
						phandle = <0x5d>;
					};

					LDO12S {
						regulator-name = "s_vdd_ldo12";
						regulator-min-microvolt = <0x19f0a0>;
						regulator-max-microvolt = <0x331df0>;
						regulator-always-on;
						regulator-ramp-delay = <0x2ee0>;
						regulator-initial-mode = <0x3>;
						linux,phandle = <0x5e>;
						phandle = <0x5e>;
					};
				};
			};
		};
	};

	fragment@52 {
		target = <0xffffffff>;

		__overlay__ {
			#address-cells = <0x1>;
			#size-cells = <0x0>;
			status = "okay";

			s2mpb02_pmic@59 {
				compatible = "s2mpb02,s2mpb02mfd";
				reg = <0x59>;
				s2mpb02,wakeup;
				pinctrl-names = "default";
				pinctrl-0 = <0x1e>;

				regulators {

					s2mpb02-buck1 {
						regulator-name = "S2MPB02_BUCK1";
						regulator-min-microvolt = <0x927c0>;
						regulator-max-microvolt = <0x19f0a0>;
						regulator-always-on;
						regulator-boot-on;
						linux,phandle = <0x5f>;
						phandle = <0x5f>;
					};

					s2mpb02-buck2 {
						regulator-name = "SVDD10";
						regulator-min-microvolt = <0x927c0>;
						regulator-max-microvolt = <0x16e360>;
						linux,phandle = <0x60>;
						phandle = <0x60>;
					};

					s2mpb02-bb {
						regulator-name = "S2MPB02_BB";
						regulator-min-microvolt = <0x27ac40>;
						regulator-max-microvolt = <0x3d0900>;
						regulator-always-on;
						regulator-boot-on;
						linux,phandle = <0x61>;
						phandle = <0x61>;
					};

					s2mpb02-ldo1 {
						regulator-name = "S2MPB02_LDO1";
						regulator-min-microvolt = <0x927c0>;
						regulator-max-microvolt = <0x2160ec>;
						linux,phandle = <0x62>;
						phandle = <0x62>;
					};

					s2mpb02-ldo2 {
						regulator-name = "S2MPB02_LDO2";
						regulator-min-microvolt = <0xea60>;
						regulator-max-microvolt = <0x2160ec>;
						linux,phandle = <0x63>;
						phandle = <0x63>;
					};

					s2mpb02-ldo3 {
						regulator-name = "VDDD_1.05V_SUB";
						regulator-min-microvolt = <0x927c0>;
						regulator-max-microvolt = <0x2160ec>;
						linux,phandle = <0x64>;
						phandle = <0x64>;
					};

					s2mpb02-ldo4 {
						regulator-name = "DVDD_REAR_CAM_1V2";
						regulator-min-microvolt = <0x927c0>;
						regulator-max-microvolt = <0x2160ec>;
						linux,phandle = <0x65>;
						phandle = <0x65>;
					};

					s2mpb02-ldo5 {
						regulator-name = "S2MPB02_LDO5";
						regulator-min-microvolt = <0x927c0>;
						regulator-max-microvolt = <0x2160ec>;
						linux,phandle = <0x66>;
						phandle = <0x66>;
					};

					s2mpb02-ldo6 {
						regulator-name = "S2MPB02_LDO6";
						regulator-min-microvolt = <0x927c0>;
						regulator-max-microvolt = <0x337f98>;
						linux,phandle = <0x67>;
						phandle = <0x67>;
					};

					s2mpb02-ldo7 {
						regulator-name = "CAM0_SVDDD18";
						regulator-min-microvolt = <0x927c0>;
						regulator-max-microvolt = <0x337f98>;
						linux,phandle = <0x68>;
						phandle = <0x68>;
					};

					s2mpb02-ldo8 {
						regulator-name = "DOVDD_REAR_CAM_1V8";
						regulator-min-microvolt = <0x927c0>;
						regulator-max-microvolt = <0x337f98>;
						linux,phandle = <0x69>;
						phandle = <0x69>;
					};

					s2mpb02-ldo9 {
						regulator-name = "S2MPB02_LDO9";
						regulator-min-microvolt = <0x927c0>;
						regulator-max-microvolt = <0x337f98>;
						regulator-always-on;
						linux,phandle = <0x6a>;
						phandle = <0x6a>;
					};

					s2mpb02-ldo10 {
						regulator-name = "S2MPB02_LDO10";
						regulator-min-microvolt = <0x927c0>;
						regulator-max-microvolt = <0x337f98>;
						regulator-always-on;
						linux,phandle = <0x6b>;
						phandle = <0x6b>;
					};

					s2mpb02-ldo11 {
						regulator-name = "S2MPB02_LDO11";
						regulator-min-microvolt = <0x927c0>;
						regulator-max-microvolt = <0x337f98>;
						regulator-always-on;
						linux,phandle = <0x6c>;
						phandle = <0x6c>;
					};

					s2mpb02-ldo12 {
						regulator-name = "CAM0_VDD28_AF";
						regulator-min-microvolt = <0x927c0>;
						regulator-max-microvolt = <0x337f98>;
						linux,phandle = <0x6d>;
						phandle = <0x6d>;
					};

					s2mpb02-ldo13 {
						regulator-name = "VDDAF_2.8V_SUB";
						regulator-min-microvolt = <0x927c0>;
						regulator-max-microvolt = <0x337f98>;
						linux,phandle = <0x6e>;
						phandle = <0x6e>;
					};

					s2mpb02-ldo14 {
						regulator-name = "S2MPB02_LDO14";
						regulator-min-microvolt = <0x927c0>;
						regulator-max-microvolt = <0x337f98>;
						linux,phandle = <0x6f>;
						phandle = <0x6f>;
					};

					s2mpb02-ldo15 {
						regulator-name = "VDD_REAR_CAM_AF_2V8";
						regulator-min-microvolt = <0x927c0>;
						regulator-max-microvolt = <0x337f98>;
						linux,phandle = <0x70>;
						phandle = <0x70>;
					};

					s2mpb02-ldo16 {
						regulator-name = "CAM0_SVDDA29";
						regulator-min-microvolt = <0x927c0>;
						regulator-max-microvolt = <0x337f98>;
						linux,phandle = <0x71>;
						phandle = <0x71>;
					};

					s2mpb02-ldo17 {
						regulator-name = "VDD_REAR_CAM_SENSOR_2V8";
						regulator-min-microvolt = <0x927c0>;
						regulator-max-microvolt = <0x337f98>;
						linux,phandle = <0x72>;
						phandle = <0x72>;
					};

					s2mpb02-ldo18 {
						regulator-name = "S2MPB02_LDO18";
						regulator-min-microvolt = <0x325aa0>;
						regulator-max-microvolt = <0x337f98>;
						linux,phandle = <0x73>;
						phandle = <0x73>;
					};
				};

				torch {
					torch1-gpio = <0xffffffff 0x3 0x1>;
					flash1-gpio = <0xffffffff 0x2 0x1>;
					status = "okay";

					leds1 {
						ledname = "leds-sec1";
						id = <0x0>;
						brightness = <0xc>;
						timeout = <0x7>;
						torch_table_enable = <0x0>;
					};

					leds2 {
						ledname = "torch-sec1";
						id = <0x1>;
						brightness = <0xc>;
						timeout = <0xf>;
						torch_table_enable = <0x1>;
						torch_table = <0x2 0x4 0x4 0x5 0x6 0x8 0x9 0xa 0xa 0xc>;
					};
				};
			};
		};
	};

	fragment@53 {
		target = <0xffffffff>;

		__overlay__ {
			status = "okay";
		};
	};

	fragment@54 {
		target = <0xffffffff>;

		__overlay__ {
			status = "okay";
		};
	};

	fragment@55 {
		target = <0xffffffff>;

		__overlay__ {
			#address-cells = <0x1>;
			#size-cells = <0x0>;
			status = "okay";
			pinctrl-names = "default";
			pinctrl-0 = <0xffffffff 0xffffffff>;

			cs47l93@0 {
				compatible = "cirrus,cs47l93";
				reg = <0x0>;
				spi-max-frequency = <0x17d7840>;
				interrupts = <0x5 0x0 0x0>;
				interrupt-controller;
				#interrupt-cells = <0x2>;
				interrupt-parent = <0xffffffff>;
				gpio-controller;
				#gpio-cells = <0x2>;
				#sound-dai-cells = <0x1>;
				AVDD-supply = <0x1f>;
				DBVDD1-supply = <0x1f>;
				CPVDD1-supply = <0x1f>;
				CPVDD2-supply = <0x20>;
				DCVDD-supply = <0x20>;
				reset-gpios = <0xffffffff 0x4 0x0>;
				cirrus,dmic-ref = <0x0 0x1 0x1 0x1>;
				cirrus,inmode = <0x2 0x2 0x0 0x0 0x2 0x2 0x1 0x1>;
				cirrus,outmono = <0x0 0x0 0x0 0x1 0x0 0x0>;
				pinctrl-names = "probe", "active";
				pinctrl-0 = <0x21>;
				pinctrl-1 = <0x21 0x22>;
				cirrus,gpsw = <0x1 0x0>;
				linux,phandle = <0x10>;
				phandle = <0x10>;

				madera-pinctrl {
					compatible = "cirrus,madera-pinctrl";
					linux,phandle = <0x74>;
					phandle = <0x74>;

					cs47l93-gpio-defaults {
						linux,phandle = <0x22>;
						phandle = <0x22>;

						aif1 {
							groups = "aif1";
							function = "aif1";
							bias-bus-hold;
						};

						aif2 {
							groups = "aif2";
							function = "aif2";
							bias-bus-hold;
						};

						aif3 {
							groups = "aif3";
							function = "aif3";
							bias-bus-hold;
						};
					};
				};

				MICBIAS1 {
					regulator-min-microvolt = <0x1b7740>;
					regulator-max-microvolt = <0x1b7740>;
					cirrus,ext-cap = <0x1>;
				};

				MICBIAS1A {
					regulator-active-discharge = <0x1>;
				};

				MICBIAS1B {
					regulator-active-discharge = <0x1>;
				};

				MICBIAS1C {
					regulator-active-discharge = <0x1>;
				};

				MICBIAS1D {
					regulator-active-discharge = <0x1>;
				};

				MICBIAS2 {
					regulator-min-microvolt = <0x2ab980>;
					regulator-max-microvolt = <0x2ab980>;
					cirrus,ext-cap = <0x1>;
				};

				MICBIAS2A {
					regulator-active-discharge = <0x1>;
				};

				cirrus,accdet {
					#address-cells = <0x1>;
					#size-cells = <0x0>;

					acc@1 {
						reg = <0x1>;
						cirrus,micd-bias-start-time = <0x1>;
						cirrus,micd-rate = <0x7>;
						cirrus,micd-detect-debounce-ms = <0x12c>;
						cirrus,micd-clamp-mode = <0x8>;
						cirrus,jd-use-jd2;
						cirrus,init-delay-ms = <0x1e>;
						cirrus,micd-dbtime = <0x1>;
						cirrus,micd-timeout-ms = <0x3e8>;
						cirrus,micd-force-micbias;
						cirrus,hpdet-short-circuit-imp = <0x3>;
						cirrus,micd-pol-gpios = <0x10 0x4 0x0>;
						cirrus,micd-ranges = <0x74 0xe2 0xad 0x246 0x141 0x73 0x2f0 0x72 0x4e9 0xd9>;
						cirrus,micd-software-compare;
						cirrus,micd-open-circuit-declare = <0x1>;
						cirrus,jd-wake-time = <0x1388>;
						cirrus,moisture-pin = <0x7>;
						cirrus,moisture-imp = <0x7d0>;
						cirrus,moisture-debounce = <0x4>;
						cirrus,micd-configs = <0x0 0x1 0x3 0x0 0x1>;
					};
				};

				controller-data {
					samsung,spi-feedback-delay = <0x1>;
					samsung,spi-chip-select-mode = <0x0>;
				};
			};
		};
	};

	fragment@56 {
		target = <0xffffffff>;

		__overlay__ {
			#address-cells = <0x1>;
			#size-cells = <0x0>;
			status = "okay";
			clock-frequency = <0xf4240>;

			max98512@3a {
				compatible = "maxim,max98512";
				#sound-dai-cells = <0x1>;
				reg = <0x3a>;
				maxim,spk-gain = <0x5>;
				maxim,sysclk = <0xbb8000>;
				maxim,vmon_slot = <0x0>;
				maxim,platform_info = <0x2 0x0 0x0 0x0 0x0 0x2a>;
				maxim,boost_step = <0xf 0xf 0xf 0xf 0xf 0xf 0xf 0xf 0xf 0xf 0xf 0xf 0xf 0xf 0x2 0x0>;
				maxim,adc_threshold = <0x7>;
				maxim,registers-of-amp = <0x1f 0x0 0x21 0xc0 0x2d 0x14 0x2f 0x0>;
				maxim,sub_reg = <0x39>;
				maxim,mono_stereo = <0x1>;
				interleave_mode = <0x1>;
				linux,phandle = <0x11>;
				phandle = <0x11>;
			};
		};
	};

	fragment@57 {
		target = <0xffffffff>;

		__overlay__ {
			status = "okay";
			use-sysmmu = "true";
			use-cache-coherency = "true";
			use-msi = "false";
			ep-device-type = <0x1>;
			pcie,wlan-gpio = <0xffffffff 0x0 0x1>;
		};
	};

	fragment@58 {
		target = <0xffffffff>;

		__overlay__ {
			status = "disabled";
			use-sysmmu = "false";
			use-cache-coherency = "true";
			use-msi = "false";
			phy-power-off = "true";
		};
	};

	fragment@59 {
		target = <0xffffffff>;

		__overlay__ {

			s2mps19mfd@00 {
				smpl_warn_dev2 = <0x0>;
			};
		};
	};

	__symbols__ {
		freq_1150 = "/fragment@mipi_freq/__overlay__/freq_1150";
		freq_1157 = "/fragment@mipi_freq/__overlay__/freq_1157";
		freq_1176 = "/fragment@mipi_freq/__overlay__/freq_1176";
		freq_1195 = "/fragment@mipi_freq/__overlay__/freq_1195";
		emul_display = "/fragment@lcd/__overlay__/emul_display";
		s6e3hf4 = "/fragment@lcd/__overlay__/s6e3hf4_wqhd";
		s6e3ha2k = "/fragment@lcd/__overlay__/s6e3ha2k_wqhd";
		s6e3ha3 = "/fragment@lcd/__overlay__/s6e3ha3_wqhd";
		s6e3ha6 = "/fragment@lcd/__overlay__/s6e3ha6_ddi";
		s6e3ha8 = "/fragment@lcd/__overlay__/s6e3ha8_ddi";
		s6e3ha9 = "/fragment@lcd/__overlay__/s6e3ha9_ddi";
		s6e3fa9_m62 = "/fragment@lcd/__overlay__/s6e3fa9_m62";
		fimc_is_sensor_2l7 = "/fragment@camera/__overlay__/fimc-is_sensor_2l7@5A";
		fimc_is_flash_gpio = "/fragment@camera/__overlay__/fimc-is-flash-gpio@0";
		fimc_is_sensor_2p8 = "/fragment@camera/__overlay__/fimc-is_sensor_2p8@5A";
		fimc_is_sensor_3m3 = "/fragment@camera/__overlay__/fimc-is_sensor_3m3@5A";
		fimc_is_sensor_5e2 = "/fragment@camera/__overlay__/fimc-is_sensor_5e2@20";
		hsi2c0_bus = "/fragment@1/__overlay__/hsi2c0-bus";
		hsi2c0_bus_in = "/fragment@1/__overlay__/hsi2c0-bus-in";
		hsi2c1_bus = "/fragment@1/__overlay__/hsi2c1-bus";
		hsi2c1_bus_in = "/fragment@1/__overlay__/hsi2c1-bus-in";
		hsi2c2_bus_in = "/fragment@1/__overlay__/hsi2c2-bus-in";
		hsi2c3_bus_in = "/fragment@1/__overlay__/hsi2c3-bus-in";
		usb_hs_tune = "/fragment@model/__overlay__/hs_tune";
		usb_ss_tune = "/fragment@model/__overlay__/ss_tune";
		dummy_audio_codec = "/fragment@model/__overlay__/audio_codec_dummy";
		dummy_audio_cpu = "/fragment@model/__overlay__/audio_cpu_dummy";
		key_home = "/fragment@16/__overlay__/key-home";
		key_voldown = "/fragment@16/__overlay__/key-voldown";
		key_volup = "/fragment@16/__overlay__/key-volup";
		key_power = "/fragment@16/__overlay__/key-power";
		dwmmc2_cd_ext_irq = "/fragment@16/__overlay__/dwmmc2_cd_ext_irq";
		m_pmic_irq = "/fragment@16/__overlay__/m-pmic-irq";
		s_pmic_irq = "/fragment@16/__overlay__/s-pmic-irq";
		sub_pmic_irq = "/fragment@16/__overlay__/sub-pmic-irq";
		if_pmic_irq = "/fragment@16/__overlay__/if-pmic-irq";
		fuel_irq = "/fragment@16/__overlay__/fuel-irq";
		usbpd_irq = "/fragment@16/__overlay__/usbpd-irq";
		phy_port = "/fragment@41/__overlay__/phy-port";
		attn_irq = "/fragment@45/__overlay__/attn-irq";
		attn_input = "/fragment@45/__overlay__/attn-input";
		codec_reset = "/fragment@45/__overlay__/codec-reset";
		buck1_reg = "/fragment@50/__overlay__/s2mps19mfd@00/regulators/BUCK1M";
		buck2_reg = "/fragment@50/__overlay__/s2mps19mfd@00/regulators/BUCK2M";
		buck3_reg = "/fragment@50/__overlay__/s2mps19mfd@00/regulators/BUCK3M";
		buck4_reg = "/fragment@50/__overlay__/s2mps19mfd@00/regulators/BUCK4M";
		buck5_reg = "/fragment@50/__overlay__/s2mps19mfd@00/regulators/BUCK5M";
		buck6_reg = "/fragment@50/__overlay__/s2mps19mfd@00/regulators/BUCK6M";
		buck7_reg = "/fragment@50/__overlay__/s2mps19mfd@00/regulators/BUCK7M";
		buck8_reg = "/fragment@50/__overlay__/s2mps19mfd@00/regulators/BUCK8M";
		buck9_reg = "/fragment@50/__overlay__/s2mps19mfd@00/regulators/BUCK9M";
		buck10_reg = "/fragment@50/__overlay__/s2mps19mfd@00/regulators/BUCK10M";
		buck11_reg = "/fragment@50/__overlay__/s2mps19mfd@00/regulators/BUCK11M";
		buck12_reg = "/fragment@50/__overlay__/s2mps19mfd@00/regulators/BUCK12M";
		ldo1_reg = "/fragment@50/__overlay__/s2mps19mfd@00/regulators/LDO1M";
		ldo2_reg = "/fragment@50/__overlay__/s2mps19mfd@00/regulators/LDO2M";
		ldo3_reg = "/fragment@50/__overlay__/s2mps19mfd@00/regulators/LDO3M";
		ldo4_reg = "/fragment@50/__overlay__/s2mps19mfd@00/regulators/LDO4M";
		ldo5_reg = "/fragment@50/__overlay__/s2mps19mfd@00/regulators/LDO5M";
		ldo6_reg = "/fragment@50/__overlay__/s2mps19mfd@00/regulators/LDO6M";
		ldo7_reg = "/fragment@50/__overlay__/s2mps19mfd@00/regulators/LDO7M";
		ldo8_reg = "/fragment@50/__overlay__/s2mps19mfd@00/regulators/LDO8M";
		ldo9_reg = "/fragment@50/__overlay__/s2mps19mfd@00/regulators/LDO9M";
		ldo10_reg = "/fragment@50/__overlay__/s2mps19mfd@00/regulators/LDO10M";
		ldo11_reg = "/fragment@50/__overlay__/s2mps19mfd@00/regulators/LDO11M";
		ldo12_reg = "/fragment@50/__overlay__/s2mps19mfd@00/regulators/LDO12M";
		ldo15_reg = "/fragment@50/__overlay__/s2mps19mfd@00/regulators/LDO15M";
		ldo16_reg = "/fragment@50/__overlay__/s2mps19mfd@00/regulators/LDO16M";
		ldo17_reg = "/fragment@50/__overlay__/s2mps19mfd@00/regulators/LDO17M";
		ldo18_reg = "/fragment@50/__overlay__/s2mps19mfd@00/regulators/LDO18M";
		ldo19_reg = "/fragment@50/__overlay__/s2mps19mfd@00/regulators/LDO19M";
		ldo20_reg = "/fragment@50/__overlay__/s2mps19mfd@00/regulators/LDO20M";
		ldo21_reg = "/fragment@50/__overlay__/s2mps19mfd@00/regulators/LDO21M";
		ldo22_reg = "/fragment@50/__overlay__/s2mps19mfd@00/regulators/LDO22M";
		ldo23_reg = "/fragment@50/__overlay__/s2mps19mfd@00/regulators/LDO23M";
		ldo24_reg = "/fragment@50/__overlay__/s2mps19mfd@00/regulators/LDO24M";
		ldo25_reg = "/fragment@50/__overlay__/s2mps19mfd@00/regulators/LDO25M";
		ldo26_reg = "/fragment@50/__overlay__/s2mps19mfd@00/regulators/LDO26M";
		ldo27_reg = "/fragment@50/__overlay__/s2mps19mfd@00/regulators/LDO27M";
		ldo28_reg = "/fragment@50/__overlay__/s2mps19mfd@00/regulators/LDO28M";
		ldo29_reg = "/fragment@50/__overlay__/s2mps19mfd@00/regulators/LDO29M";
		s_buck1_reg = "/fragment@51/__overlay__/s2mps20mfd@00/regulators/BUCK1S";
		s_buck2_reg = "/fragment@51/__overlay__/s2mps20mfd@00/regulators/BUCK2S";
		s_ldo1_reg = "/fragment@51/__overlay__/s2mps20mfd@00/regulators/LDO1S";
		s_ldo2_reg = "/fragment@51/__overlay__/s2mps20mfd@00/regulators/LDO2S";
		s_ldo7_reg = "/fragment@51/__overlay__/s2mps20mfd@00/regulators/LDO7S";
		s_ldo8_reg = "/fragment@51/__overlay__/s2mps20mfd@00/regulators/LDO8S";
		s_ldo9_reg = "/fragment@51/__overlay__/s2mps20mfd@00/regulators/LDO9S";
		s_ldo10_reg = "/fragment@51/__overlay__/s2mps20mfd@00/regulators/LDO10S";
		s_ldo11_reg = "/fragment@51/__overlay__/s2mps20mfd@00/regulators/LDO11S";
		s_ldo12_reg = "/fragment@51/__overlay__/s2mps20mfd@00/regulators/LDO12S";
		_buck1_reg = "/fragment@52/__overlay__/s2mpb02_pmic@59/regulators/s2mpb02-buck1";
		_buck2_reg = "/fragment@52/__overlay__/s2mpb02_pmic@59/regulators/s2mpb02-buck2";
		_buckboost_reg = "/fragment@52/__overlay__/s2mpb02_pmic@59/regulators/s2mpb02-bb";
		_ldo1_reg = "/fragment@52/__overlay__/s2mpb02_pmic@59/regulators/s2mpb02-ldo1";
		_ldo2_reg = "/fragment@52/__overlay__/s2mpb02_pmic@59/regulators/s2mpb02-ldo2";
		_ldo3_reg = "/fragment@52/__overlay__/s2mpb02_pmic@59/regulators/s2mpb02-ldo3";
		_ldo4_reg = "/fragment@52/__overlay__/s2mpb02_pmic@59/regulators/s2mpb02-ldo4";
		_ldo5_reg = "/fragment@52/__overlay__/s2mpb02_pmic@59/regulators/s2mpb02-ldo5";
		_ldo6_reg = "/fragment@52/__overlay__/s2mpb02_pmic@59/regulators/s2mpb02-ldo6";
		_ldo7_reg = "/fragment@52/__overlay__/s2mpb02_pmic@59/regulators/s2mpb02-ldo7";
		_ldo8_reg = "/fragment@52/__overlay__/s2mpb02_pmic@59/regulators/s2mpb02-ldo8";
		_ldo9_reg = "/fragment@52/__overlay__/s2mpb02_pmic@59/regulators/s2mpb02-ldo9";
		_ldo10_reg = "/fragment@52/__overlay__/s2mpb02_pmic@59/regulators/s2mpb02-ldo10";
		_ldo11_reg = "/fragment@52/__overlay__/s2mpb02_pmic@59/regulators/s2mpb02-ldo11";
		_ldo12_reg = "/fragment@52/__overlay__/s2mpb02_pmic@59/regulators/s2mpb02-ldo12";
		_ldo13_reg = "/fragment@52/__overlay__/s2mpb02_pmic@59/regulators/s2mpb02-ldo13";
		_ldo14_reg = "/fragment@52/__overlay__/s2mpb02_pmic@59/regulators/s2mpb02-ldo14";
		_ldo15_reg = "/fragment@52/__overlay__/s2mpb02_pmic@59/regulators/s2mpb02-ldo15";
		_ldo16_reg = "/fragment@52/__overlay__/s2mpb02_pmic@59/regulators/s2mpb02-ldo16";
		_ldo17_reg = "/fragment@52/__overlay__/s2mpb02_pmic@59/regulators/s2mpb02-ldo17";
		_ldo18_reg = "/fragment@52/__overlay__/s2mpb02_pmic@59/regulators/s2mpb02-ldo18";
		cs47l93 = "/fragment@55/__overlay__/cs47l93@0";
		madera_pinctrl = "/fragment@55/__overlay__/cs47l93@0/madera-pinctrl";
		cs47l93_defaults = "/fragment@55/__overlay__/cs47l93@0/madera-pinctrl/cs47l93-gpio-defaults";
		max98512 = "/fragment@56/__overlay__/max98512@3a";
	};

	__fixups__ {
		sensor_mclk0_out = "/fragment@camera/__overlay__/fimc-is_sensor_2l7@5A:pinctrl-1:0", "/fragment@camera/__overlay__/fimc-is_sensor_3m3@5A:pinctrl-1:0";
		sensor_mclk0_fn = "/fragment@camera/__overlay__/fimc-is_sensor_2l7@5A:pinctrl-2:0", "/fragment@camera/__overlay__/fimc-is_sensor_3m3@5A:pinctrl-2:0";
		gpc1 = "/fragment@camera/__overlay__/fimc-is_sensor_2l7@5A:gpio_mclk:0", "/fragment@camera/__overlay__/fimc-is_sensor_2p8@5A:gpio_mclk:0", "/fragment@camera/__overlay__/fimc-is_sensor_3m3@5A:gpio_mclk:0", "/fragment@camera/__overlay__/fimc-is_sensor_5e2@20:gpio_mclk:0";
		gpa1 = "/fragment@camera/__overlay__/fimc-is_sensor_2l7@5A:gpio_reset:0", "/fragment@camera/__overlay__/fimc-is_sensor_2p8@5A:gpio_reset:0", "/fragment@camera/__overlay__/fimc-is_sensor_3m3@5A:gpio_reset:0", "/fragment@47/__overlay__/s2mu004@3d:s2mu004,irq-gpio:0", "/fragment@48/__overlay__/s2mu004-fuelgauge@3B:fuelgauge,fuel_int:0";
		gpg2 = "/fragment@camera/__overlay__/fimc-is-flash-gpio@0:torch-gpio:0", "/fragment@18/__overlay__:gpios:12", "/fragment@46/__overlay__/touchscreen@48:sec,irq_gpio:0", "/fragment@52/__overlay__/s2mpb02_pmic@59/torch:torch1-gpio:0", "/fragment@55/__overlay__/cs47l93@0:reset-gpios:0";
		gpg1 = "/fragment@camera/__overlay__/fimc-is-flash-gpio@0:flash-gpio:0", "/fragment@52/__overlay__/s2mpb02_pmic@59/torch:flash1-gpio:0", "/fragment@57/__overlay__:pcie,wlan-gpio:0";
		sensor_mclk1_out = "/fragment@camera/__overlay__/fimc-is_sensor_2p8@5A:pinctrl-1:0";
		sensor_mclk1_fn = "/fragment@camera/__overlay__/fimc-is_sensor_2p8@5A:pinctrl-2:0";
		sensor_mclk3_out = "/fragment@camera/__overlay__/fimc-is_sensor_5e2@20:pinctrl-1:0";
		sensor_mclk3_fn = "/fragment@camera/__overlay__/fimc-is_sensor_5e2@20:pinctrl-2:0";
		gpm18 = "/fragment@camera/__overlay__/fimc-is_sensor_5e2@20:gpio_reset:0";
		fimc_is = "/fragment@0:target:0";
		pinctrl_6 = "/fragment@1:target:0", "/fragment@41:target:0";
		hsi2c_0 = "/fragment@2:target:0";
		gpc0 = "/fragment@2/__overlay__:gpios:0", "/fragment@2/__overlay__:gpios:12", "/fragment@3/__overlay__:gpios:0", "/fragment@3/__overlay__:gpios:12", "/fragment@4/__overlay__:gpios:0", "/fragment@4/__overlay__:gpios:12", "/fragment@5/__overlay__:gpios:0", "/fragment@5/__overlay__:gpios:12";
		hsi2c_1 = "/fragment@3:target:0";
		hsi2c_2 = "/fragment@4:target:0";
		hsi2c2_bus = "/fragment@4/__overlay__:pinctrl-1:0";
		hsi2c_3 = "/fragment@5:target:0";
		hsi2c3_bus = "/fragment@5/__overlay__:pinctrl-1:0";
		fimc_is_sensor0 = "/fragment@6:target:0";
		fimc_is_sensor1 = "/fragment@7:target:0";
		fimc_is_sensor2 = "/fragment@8:target:0";
		fimc_is_sensor3 = "/fragment@9:target:0";
		fimc_is_sensor4 = "/fragment@10:target:0";
		gpa3 = "/fragment@model/__overlay__/gpio_keys/button@1:gpios:0", "/fragment@model/__overlay__/gpio_keys/button@4:gpios:0", "/fragment@49/__overlay__/usbpd-s2mm005@33:interrupt-parent:0", "/fragment@49/__overlay__/usbpd-s2mm005@33:usbpd,usbpd_int:0";
		gpa2 = "/fragment@model/__overlay__/gpio_keys/button@2:gpios:0", "/fragment@model/__overlay__/gpio_keys/button@3:gpios:0";
		udc = "/fragment@model/__overlay__/usb_notifier:udc:0", "/fragment@42:target:0";
		clock = "/fragment@model/__overlay__/sound:clocks:0";
		abox = "/fragment@model/__overlay__/sound:samsung,codec:0", "/fragment@model/__overlay__/sound/sifs0/cpu:sound-dai:0", "/fragment@model/__overlay__/sound/sifs1/cpu:sound-dai:0", "/fragment@model/__overlay__/sound/sifs2/cpu:sound-dai:0", "/fragment@model/__overlay__/sound/sifs3/cpu:sound-dai:0", "/fragment@model/__overlay__/sound/sifs4/cpu:sound-dai:0", "/fragment@model/__overlay__/sound/rsrc0/cpu:sound-dai:0", "/fragment@model/__overlay__/sound/rsrc1/cpu:sound-dai:0", "/fragment@model/__overlay__/sound/nsrc0/cpu:sound-dai:0", "/fragment@model/__overlay__/sound/nsrc1/cpu:sound-dai:0", "/fragment@model/__overlay__/sound/nsrc2/cpu:sound-dai:0", "/fragment@model/__overlay__/sound/nsrc3/cpu:sound-dai:0", "/fragment@model/__overlay__/sound/nsrc4/cpu:sound-dai:0", "/fragment@model/__overlay__/sound/nsrc5/cpu:sound-dai:0", "/fragment@model/__overlay__/sound/nsrc6/cpu:sound-dai:0", "/fragment@54:target:0";
		abox_uaif_0 = "/fragment@model/__overlay__/sound:samsung,codec:4", "/fragment@model/__overlay__/sound/uaif0/cpu:sound-dai:0";
		abox_uaif_1 = "/fragment@model/__overlay__/sound:samsung,codec:8", "/fragment@model/__overlay__/sound/uaif1/cpu:sound-dai:0";
		abox_uaif_2 = "/fragment@model/__overlay__/sound:samsung,codec:12", "/fragment@model/__overlay__/sound/uaif2/cpu:sound-dai:0";
		abox_uaif_3 = "/fragment@model/__overlay__/sound:samsung,codec:16", "/fragment@model/__overlay__/sound/uaif3/cpu:sound-dai:0";
		abox_dsif = "/fragment@model/__overlay__/sound:samsung,codec:20", "/fragment@model/__overlay__/sound/dsif0/cpu:sound-dai:0";
		abox_rdma_0 = "/fragment@model/__overlay__/sound:samsung,codec:24", "/fragment@model/__overlay__/sound/rdma0/cpu:sound-dai:0", "/fragment@model/__overlay__/sound/rdma0/platform:sound-dai:0";
		abox_rdma_1 = "/fragment@model/__overlay__/sound:samsung,codec:28", "/fragment@model/__overlay__/sound/rdma1/cpu:sound-dai:0", "/fragment@model/__overlay__/sound/rdma1/platform:sound-dai:0";
		abox_rdma_2 = "/fragment@model/__overlay__/sound:samsung,codec:32", "/fragment@model/__overlay__/sound/rdma2/cpu:sound-dai:0", "/fragment@model/__overlay__/sound/rdma2/platform:sound-dai:0";
		abox_rdma_3 = "/fragment@model/__overlay__/sound:samsung,codec:36", "/fragment@model/__overlay__/sound/rdma3/cpu:sound-dai:0", "/fragment@model/__overlay__/sound/rdma3/platform:sound-dai:0";
		abox_rdma_4 = "/fragment@model/__overlay__/sound:samsung,codec:40", "/fragment@model/__overlay__/sound/rdma4/cpu:sound-dai:0", "/fragment@model/__overlay__/sound/rdma4/platform:sound-dai:0";
		abox_rdma_5 = "/fragment@model/__overlay__/sound:samsung,codec:44", "/fragment@model/__overlay__/sound/rdma5/cpu:sound-dai:0", "/fragment@model/__overlay__/sound/rdma5/platform:sound-dai:0";
		abox_rdma_6 = "/fragment@model/__overlay__/sound:samsung,codec:48", "/fragment@model/__overlay__/sound/rdma6/cpu:sound-dai:0", "/fragment@model/__overlay__/sound/rdma6/platform:sound-dai:0";
		abox_rdma_7 = "/fragment@model/__overlay__/sound:samsung,codec:52", "/fragment@model/__overlay__/sound/rdma7/cpu:sound-dai:0", "/fragment@model/__overlay__/sound/rdma7/platform:sound-dai:0";
		abox_rdma_8 = "/fragment@model/__overlay__/sound:samsung,codec:56", "/fragment@model/__overlay__/sound/rdma8/cpu:sound-dai:0", "/fragment@model/__overlay__/sound/rdma8/platform:sound-dai:0";
		abox_rdma_9 = "/fragment@model/__overlay__/sound:samsung,codec:60", "/fragment@model/__overlay__/sound/rdma9/cpu:sound-dai:0", "/fragment@model/__overlay__/sound/rdma9/platform:sound-dai:0";
		abox_rdma_10 = "/fragment@model/__overlay__/sound:samsung,codec:64", "/fragment@model/__overlay__/sound/rdma10/cpu:sound-dai:0", "/fragment@model/__overlay__/sound/rdma10/platform:sound-dai:0";
		abox_rdma_11 = "/fragment@model/__overlay__/sound:samsung,codec:68", "/fragment@model/__overlay__/sound/rdma11/cpu:sound-dai:0", "/fragment@model/__overlay__/sound/rdma11/platform:sound-dai:0";
		abox_wdma_0 = "/fragment@model/__overlay__/sound:samsung,codec:72", "/fragment@model/__overlay__/sound/wdma0/cpu:sound-dai:0", "/fragment@model/__overlay__/sound/wdma0/platform:sound-dai:0";
		abox_wdma_1 = "/fragment@model/__overlay__/sound:samsung,codec:76", "/fragment@model/__overlay__/sound/wdma1/cpu:sound-dai:0", "/fragment@model/__overlay__/sound/wdma1/platform:sound-dai:0";
		abox_wdma_2 = "/fragment@model/__overlay__/sound:samsung,codec:80", "/fragment@model/__overlay__/sound/wdma2/cpu:sound-dai:0", "/fragment@model/__overlay__/sound/wdma2/platform:sound-dai:0";
		abox_wdma_3 = "/fragment@model/__overlay__/sound:samsung,codec:84", "/fragment@model/__overlay__/sound/wdma3/cpu:sound-dai:0", "/fragment@model/__overlay__/sound/wdma3/platform:sound-dai:0";
		abox_wdma_4 = "/fragment@model/__overlay__/sound:samsung,codec:88", "/fragment@model/__overlay__/sound/wdma4/cpu:sound-dai:0", "/fragment@model/__overlay__/sound/wdma4/platform:sound-dai:0";
		abox_wdma_5 = "/fragment@model/__overlay__/sound:samsung,codec:92", "/fragment@model/__overlay__/sound/wdma5/cpu:sound-dai:0", "/fragment@model/__overlay__/sound/wdma5/platform:sound-dai:0";
		abox_wdma_6 = "/fragment@model/__overlay__/sound:samsung,codec:96", "/fragment@model/__overlay__/sound/wdma6/cpu:sound-dai:0", "/fragment@model/__overlay__/sound/wdma6/platform:sound-dai:0";
		abox_wdma_7 = "/fragment@model/__overlay__/sound:samsung,codec:100", "/fragment@model/__overlay__/sound/wdma7/cpu:sound-dai:0", "/fragment@model/__overlay__/sound/wdma7/platform:sound-dai:0";
		vts = "/fragment@model/__overlay__/sound:samsung,codec:104", "/fragment@model/__overlay__/sound/vts0/cpu:sound-dai:0", "/fragment@model/__overlay__/sound/vts1/cpu:sound-dai:0";
		abox_effect = "/fragment@model/__overlay__/sound:samsung,aux:0";
		chosen = "/fragment@11:target:0";
		reserved_memory = "/fragment@12:target:0";
		mali = "/fragment@13:target:0";
		dwmmc_2 = "/fragment@14:target:0";
		sd2_clk = "/fragment@14/__overlay__:pinctrl-0:0", "/fragment@14/__overlay__:pinctrl-8:0";
		sd2_cmd = "/fragment@14/__overlay__:pinctrl-0:4", "/fragment@14/__overlay__:pinctrl-8:4";
		sd2_bus1 = "/fragment@14/__overlay__:pinctrl-0:8", "/fragment@14/__overlay__:pinctrl-8:8";
		sd2_bus4 = "/fragment@14/__overlay__:pinctrl-0:12", "/fragment@14/__overlay__:pinctrl-8:12";
		sd2_clk_fast_slew_rate_1x = "/fragment@14/__overlay__:pinctrl-1:0";
		sd2_clk_fast_slew_rate_1_5x = "/fragment@14/__overlay__:pinctrl-2:0";
		sd2_clk_fast_slew_rate_2x = "/fragment@14/__overlay__:pinctrl-3:0";
		sd2_clk_fast_slew_rate_2_5x = "/fragment@14/__overlay__:pinctrl-4:0";
		sd2_clk_fast_slew_rate_3x = "/fragment@14/__overlay__:pinctrl-5:0";
		sd2_clk_fast_slew_rate_4x = "/fragment@14/__overlay__:pinctrl-6:0";
		sd2_pins_as_pdn = "/fragment@14/__overlay__:pinctrl-7:0";
		gpa0 = "/fragment@14/__overlay__:card-detect:0", "/fragment@50/__overlay__/s2mps19mfd@00:s2mps19,irq-gpio:0", "/fragment@50/__overlay__/s2mps19mfd@00:interrupt-parent:0", "/fragment@51/__overlay__/s2mps20mfd@00:s2mps20,irq-gpio:0", "/fragment@51/__overlay__/s2mps20mfd@00:interrupt-parent:0", "/fragment@55/__overlay__/cs47l93@0:interrupt-parent:0";
		serial_0 = "/fragment@15:target:0";
		pinctrl_0 = "/fragment@16:target:0";
		fmp_0 = "/fragment@17:target:0";
		dsim_0 = "/fragment@18:target:0";
		gpg3 = "/fragment@18/__overlay__:gpios:0";
		usi_0 = "/fragment@19:target:0";
		usi_1 = "/fragment@20:target:0";
		usi_2 = "/fragment@21:target:0";
		usi_3 = "/fragment@22:target:0";
		usi_4 = "/fragment@23:target:0";
		usi_5 = "/fragment@24:target:0";
		usi_6 = "/fragment@25:target:0";
		usi_7 = "/fragment@26:target:0";
		usi_8 = "/fragment@27:target:0";
		usi_9 = "/fragment@28:target:0";
		usi_10 = "/fragment@29:target:0";
		usi_11 = "/fragment@30:target:0";
		usi_12 = "/fragment@31:target:0";
		usi_13 = "/fragment@32:target:0";
		usi_14 = "/fragment@33:target:0";
		usi_15 = "/fragment@34:target:0";
		usi_16 = "/fragment@35:target:0";
		usi_17 = "/fragment@36:target:0";
		usi_00_cmgp = "/fragment@37:target:0";
		usi_01_cmgp = "/fragment@38:target:0";
		usi_02_cmgp = "/fragment@39:target:0";
		usi_03_cmgp = "/fragment@40:target:0";
		usbdrd_dwc3 = "/fragment@43:target:0";
		usbdrd_phy0 = "/fragment@44:target:0";
		gpp4 = "/fragment@44/__overlay__:phy,gpio_phy_port:0";
		pinctrl_5 = "/fragment@45:target:0";
		hsi2c_4 = "/fragment@46:target:0";
		hsi2c_21 = "/fragment@47:target:0";
		hsi2c_10 = "/fragment@48:target:0";
		hsi2c_23 = "/fragment@49:target:0";
		speedy = "/fragment@50:target:0", "/fragment@59:target:0";
		smpl_warn = "/fragment@50/__overlay__/s2mps19mfd@00:pinctrl-0:4";
		gpp3 = "/fragment@50/__overlay__/s2mps19mfd@00:gpios:0";
		speedy1 = "/fragment@51:target:0";
		hsi2c_20 = "/fragment@52:target:0";
		abox_gic = "/fragment@53:target:0";
		spi_5 = "/fragment@55:target:0";
		spi5_bus = "/fragment@55/__overlay__:pinctrl-0:0";
		spi5_cs_func = "/fragment@55/__overlay__:pinctrl-0:4";
		hsi2c_5 = "/fragment@56:target:0";
		pcie_0 = "/fragment@57:target:0";
		pcie_1 = "/fragment@58:target:0";
	};

	__local_fixups__ {

		fragment@lcd {

			__overlay__ {

				s6e3fa9_m62 {
					dynamic_freq = <0x0 0x4 0x8 0xc>;
				};
			};
		};

		fragment@2 {

			__overlay__ {
				pinctrl-0 = <0x0>;
				pinctrl-1 = <0x0>;
				pinctrl-2 = <0x0>;
			};
		};

		fragment@3 {

			__overlay__ {
				pinctrl-0 = <0x0>;
				pinctrl-1 = <0x0>;
				pinctrl-2 = <0x0>;
			};
		};

		fragment@4 {

			__overlay__ {
				pinctrl-0 = <0x0>;
				pinctrl-2 = <0x0>;
			};
		};

		fragment@5 {

			__overlay__ {
				pinctrl-0 = <0x0>;
				pinctrl-2 = <0x0>;
			};
		};

		fragment@model {

			__overlay__ {

				gpio_keys {
					pinctrl-0 = <0x0 0x4 0x8 0xc>;
				};

				sound {

					rdma0 {

						codec {
							sound-dai = <0x0>;
						};
					};

					rdma1 {

						codec {
							sound-dai = <0x0>;
						};
					};

					rdma2 {

						codec {
							sound-dai = <0x0>;
						};
					};

					rdma3 {

						codec {
							sound-dai = <0x0>;
						};
					};

					rdma4 {

						codec {
							sound-dai = <0x0>;
						};
					};

					rdma5 {

						codec {
							sound-dai = <0x0>;
						};
					};

					rdma6 {

						codec {
							sound-dai = <0x0>;
						};
					};

					rdma7 {

						codec {
							sound-dai = <0x0>;
						};
					};

					rdma8 {

						codec {
							sound-dai = <0x0>;
						};
					};

					rdma9 {

						codec {
							sound-dai = <0x0>;
						};
					};

					rdma10 {

						codec {
							sound-dai = <0x0>;
						};
					};

					rdma11 {

						codec {
							sound-dai = <0x0>;
						};
					};

					wdma0 {

						codec {
							sound-dai = <0x0>;
						};
					};

					wdma1 {

						codec {
							sound-dai = <0x0>;
						};
					};

					wdma2 {

						codec {
							sound-dai = <0x0>;
						};
					};

					wdma3 {

						codec {
							sound-dai = <0x0>;
						};
					};

					wdma4 {

						codec {
							sound-dai = <0x0>;
						};
					};

					wdma5 {

						codec {
							sound-dai = <0x0>;
						};
					};

					wdma6 {

						codec {
							sound-dai = <0x0>;
						};
					};

					wdma7 {

						codec {
							sound-dai = <0x0>;
						};
					};

					vts0 {

						codec {
							sound-dai = <0x0>;
						};
					};

					vts1 {

						codec {
							sound-dai = <0x0>;
						};
					};

					uaif0 {

						codec {
							sound-dai = <0x0>;
						};
					};

					uaif1 {

						codec {
							sound-dai = <0x0>;
						};
					};

					uaif2 {

						codec {
							sound-dai = <0x0>;
						};
					};

					uaif3 {

						codec {
							sound-dai = <0x0>;
						};
					};

					dsif0 {

						codec {
							sound-dai = <0x0>;
						};
					};

					sifs0 {

						codec {
							sound-dai = <0x0>;
						};
					};

					sifs1 {

						codec {
							sound-dai = <0x0>;
						};
					};

					sifs2 {

						codec {
							sound-dai = <0x0>;
						};
					};

					sifs3 {

						codec {
							sound-dai = <0x0>;
						};
					};

					sifs4 {

						codec {
							sound-dai = <0x0>;
						};
					};

					rsrc0 {

						codec {
							sound-dai = <0x0>;
						};
					};

					rsrc1 {

						codec {
							sound-dai = <0x0>;
						};
					};

					nsrc0 {

						codec {
							sound-dai = <0x0>;
						};
					};

					nsrc1 {

						codec {
							sound-dai = <0x0>;
						};
					};

					nsrc2 {

						codec {
							sound-dai = <0x0>;
						};
					};

					nsrc3 {

						codec {
							sound-dai = <0x0>;
						};
					};

					nsrc4 {

						codec {
							sound-dai = <0x0>;
						};
					};

					nsrc5 {

						codec {
							sound-dai = <0x0>;
						};
					};

					nsrc6 {

						codec {
							sound-dai = <0x0>;
						};
					};

					debug-trace@1 {

						cpu {
							sound-dai = <0x0>;
						};

						codec {
							sound-dai = <0x0>;
						};
					};
				};
			};
		};

		fragment@14 {

			__overlay__ {
				pinctrl-0 = <0x10>;
			};
		};

		fragment@18 {

			__overlay__ {
				lcd_info = <0x0>;
			};
		};

		fragment@44 {

			__overlay__ {
				pinctrl-0 = <0x0>;
				hs_tune_param = <0x0>;
				ss_tune_param = <0x0>;
			};
		};

		fragment@46 {

			__overlay__ {

				touchscreen@48 {
					pinctrl-0 = <0x0>;
					pinctrl-1 = <0x0>;
				};
			};
		};

		fragment@47 {

			__overlay__ {

				s2mu004@3d {
					pinctrl-0 = <0x0>;
				};
			};
		};

		fragment@48 {

			__overlay__ {

				s2mu004-fuelgauge@3B {
					pinctrl-0 = <0x0>;
				};
			};
		};

		fragment@49 {

			__overlay__ {

				usbpd-s2mm005@33 {
					pinctrl-0 = <0x0>;
				};
			};
		};

		fragment@50 {

			__overlay__ {

				s2mps19mfd@00 {
					pinctrl-0 = <0x0>;
				};
			};
		};

		fragment@51 {

			__overlay__ {

				s2mps20mfd@00 {
					pinctrl-0 = <0x0>;
				};
			};
		};

		fragment@52 {

			__overlay__ {

				s2mpb02_pmic@59 {
					pinctrl-0 = <0x0>;
				};
			};
		};

		fragment@55 {

			__overlay__ {

				cs47l93@0 {
					AVDD-supply = <0x0>;
					DBVDD1-supply = <0x0>;
					CPVDD1-supply = <0x0>;
					CPVDD2-supply = <0x0>;
					DCVDD-supply = <0x0>;
					pinctrl-0 = <0x0>;
					pinctrl-1 = <0x0 0x4>;

					cirrus,accdet {

						acc@1 {
							cirrus,micd-pol-gpios = <0x0>;
						};
					};
				};
			};
		};
	};
};
