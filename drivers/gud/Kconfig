## drivers/gud/Kconfig
```kconfig
#
# Mobicore Configuration
#
if SOC_EXYNOS9810
source "drivers/gud/gud-exynos9810/Kconfig"
endif

if SOC_EXYNOS9820
endif
```

## drivers/spu_verify/Kconfig
```kconfig
config SPU_VERIFY
	bool "SPU Sign Verify Driver"
    select ASYMMETRIC_KEY_TYPE
    select ASYMMETRIC_PUBLIC_KEY_SUBTYPE
    select CRYPTO_RSA
	default n
	help
	  This option enables SPU sign verify driver.
	  When SPU fireware update, image signature verify.
	  Each firmware is checked by calling a function before updating.
	  If disable config, maybe Signature checking cause problems.
```
